AUTOSAR XML (schema 4-2-1)
package /BMW/Boardnet/EcuComposition/KombiComposition
  composition sw component type Kombi_CPUComponent
    45 x component:
      iicb_Prototype: type=iicb
      IOSAL_Prototype: type=IOSAL
      SwcCDBus_Prototype: type=SwcCDBus
      SwcUcv_Prototype: type=SwcUcv
      CDDBIF_Prototype: type=CDDBIF
      SwcGear_Prototype: type=SwcGear
      CddVMon_Prototype: type=CddVMon
      SwcAtp_Prototype: type=SwcAtp
      SwcOdo_Prototype: type=SwcOdo
      SwcCcm_Prototype: type=SwcCcm
      SwcTnk_Prototype: type=SwcTnk
      CddErm_Prototype: type=CddErm
      SwcKlb_Prototype: type=SwcKlb
      BifSample_Prototype: type=BifSample
      SwcBc_Prototype: type=SwcBc
      HMIIF_Prototype: type=HMIIF
      SPD_Prototype: type=SPD
      PiaWrp_Prototype: type=PiaWrp
      SwcEci_Prototype: type=SwcEci
      SwcDim_Prototype: type=SwcDim
      AC_SAFM_Prototype: type=AC_SAFM
      SwcLdm_Prototype: type=SwcLdm
      SwcRda_Prototype: type=SwcRda
      SwcElc_Prototype: type=SwcElc
      CDD_AMM_Prototype: type=CDD_AMM
      CddStub_Prototype: type=CddStub
      SwcKsm_Prototype: type=SwcKsm
      SwcBcWrp_Prototype: type=SwcBcWrp
      SwcDimWrp_Prototype: type=SwcDimWrp
      CddSwcDfe_Prototype: type=CddSwcDfe
      CddDfeLld_Prototype: type=CddDfeLld
      SwcOdoWrp_Prototype: type=SwcOdoWrp
      SwcCcmWrp_Prototype: type=SwcCcmWrp
      SwcCbsWrp_Prototype: type=SwcCbsWrp
      CddSafMLLD_Prototype: type=CddSafMLLD
      CddHal_Prototype: type=CddHal
      CddHud_Prototype: type=CddHud
      SwcTST_Prototype: type=SwcTST
      SwcTmm_Prototype: type=SwcTmm
      SwcCbs_Prototype: type=SwcCbs
      CddVMonWrp_Prototype: type=CddVMonWrp
      SwcLdmWrp_Prototype: type=SwcLdmWrp
      ErmWrp_Prototype: type=ErmWrp
      SwcGbl_Prototype: type=SwcGbl
      Cdd_CustomerTime_Prototype: type=Cdd_CustomerTime
    connect Csm.CsmKey_CA_SecureToken_KeyManagement -> Bs.CsmKeyManagement_CACert_SecureToken
    connect Csm.CsmKey_CA_ID_KeyManagement -> Bs.CsmKeyManagement_CACert_ID
    connect Csm.CsmKey_Id_Zertifikat_KeyManagement -> Bs.CsmKeyManagement_Certificate_ID
    connect Csm.CsmKey_TmpCert1_KeyManagement -> Bs.CsmKeyManagement_TmpCert1
    connect Dlog.EcuInfo -> Scs.DlogEcuInfo
    connect Csm.CsmJob_CsmRandomGenerate_Scs_RandomGenerate -> Scs.CsmRandomGenerate_Scs
    connect Bs.LockingConfigurationSwitch_0 -> Scs.BsLCSStateSecOCByPass
    connect Bs.NvMNotifyJobFinishedCertState -> NvM.PNJobFinished_NvM_BLOCK_BsNvMCertificates
    connect Bs.SecEcuMode -> StdDiag.SecureEcuModePort
    connect Bs.SecureFeature -> StdDiag.SecureFeaturePort
    connect Dlog.EcuInfo -> Darh.DlogPort
    connect Bs.ActivationState_Features_Darh -> Darh.SecureFeatureActivation
    connect Csm.CsmKey_CsrID_KeyManagement -> Bs.CsmKeyManagement_CsrKey_ID
    connect Csm.CsmJob_Bs_SignatureGenerateCsrID_SignatureGenerate -> Bs.CsmSignatureGenerate_Csr_ID
    connect Csm.CsmJob_Bs_SignatureGenerateSecOCKeyList_SignatureGenerate -> Bs.CsmSignatureGenerate_SecOCKeyList
    connect Csm.CsmJob_Bs_SignatureVerifySecureToken_SignatureVerify -> Bs.CsmSignatureVerify_SecureToken
    connect Csm.CsmJob_Bs_SignatureVerifyTmpCert1_SignatureVerify -> Bs.CsmSignatureVerify_TmpCert1
    connect DemInstance.Event_SecocKeypackValidationfailed -> Bs.DMSecOCKeypackValidationFailed
    connect Bs.DataService_StatusCertificates -> DemInstance.CBReadData_DemExternalCSDataElementClass_CertificationManagementBindings
    connect Bs.DataService_StatusCertificates -> DemInstance.CBReadData_DemExternalCSDataElementClass_CertificationManagementCertificate
    connect Bs.DataService_StatusOtherBindings -> DemInstance.CBReadData_DemExternalCSDataElementClass_CertificationManagementOtherBindings
    connect Bs.DataService_StatusSymmetricKeys -> DemInstance.CBReadData_DemExternalCSDataElementClass_StatusSymmetricKeys
    connect Bs.StdDiag_AdueCertificates -> StdDiag.Adt_ApplicationRoutineControlIdentifier_CertificateManagementAdue_CtrlID_0x0
    connect Bs.StdDiag_AdueSecOCKeyPack -> StdDiag.Adt_ApplicationRoutineControlIdentifier_CtrlID_0x5
    connect DemInstance.Event_SecocFvSyncfailed -> Scs.DMSecOCCtrResyncFailed
    connect CDDBIF_Prototype.pport_If_cs_AnyToBif -> BifSample_Prototype.rport_If_ca_BifSampleToBif
    connect BifSample_Prototype.pport_If_cs_BifToBifSample -> CDDBIF_Prototype.rport_If_cs_BifToSample
    connect SwcUcv_Prototype.pport_If_sr_Bc_Speed_To_Hmi -> HMIIF_Prototype.rport_If_sr_Bc_Speed_To_Hmi
    connect SwcUcv_Prototype.pport_If_sr_Bc_Range_To_Hmi -> HMIIF_Prototype.rport_If_sr_Bc_Range_To_Hmi
    connect SwcUcv_Prototype.pport_If_sr_Bc_Average_To_Hmi -> HMIIF_Prototype.rport_If_sr_Bc_Average_To_Hmi
    connect SwcUcv_Prototype.pport_If_sr_Bc_Consumption_To_Hmi -> HMIIF_Prototype.rport_If_sr_Bc_Consumption_To_Hmi
    connect SwcUcv_Prototype.pport_If_sr_Tnk_To_Hmi -> HMIIF_Prototype.rport_If_sr_Tnk_To_Hmi
    connect SwcUcv_Prototype.pport_If_sr_Hmi_TestMenu -> HMIIF_Prototype.rport_If_sr_Hmi_TestMenu
    connect HMIIF_Prototype.pport_If_cs_HMI_TM -> SwcUcv_Prototype.rport_If_cs_HMI_TM
    connect SwcUcv_Prototype.pport_If_sr_Ucv_HmiGaugeValues -> HMIIF_Prototype.rport_If_sr_Ucv_HmiGaugeValues
    connect Bs.SecEcuMode -> SecM.SecEcuMode
    connect Bs.LifeCycle -> SecM.LifeCycle
    connect SwcUcv_Prototype.pport_If_cs_Ucv_Converter -> SwcBc_Prototype.rport_If_cs_Ucv_Converter
    connect SwcBc_Prototype.pport_If_sr_Bc_Range -> SwcUcv_Prototype.rport_If_sr_Bc_Range
    connect SwcBc_Prototype.pport_If_sr_Bc_Speed -> SwcUcv_Prototype.rport_If_sr_Bc_Speed
    connect SwcBc_Prototype.pport_If_sr_Bc_Consumption -> SwcUcv_Prototype.rport_If_sr_Bc_Consumption
    connect SwcTnk_Prototype.pport_If_sr_Tnk -> SwcUcv_Prototype.rport_If_sr_Tnk
    connect SwcAtp_Prototype.pport_If_sr_Atp -> SwcUcv_Prototype.rport_If_sr_Atp
    connect SwcOdo_Prototype.pport_If_sr_Odo -> SwcUcv_Prototype.rport_If_sr_Odo
    connect SwcBc_Prototype.pport_If_sr_Bc_Average -> SwcUcv_Prototype.rport_If_sr_Bc_Average
    connect SwcBc_Prototype.pport_If_sr_Bc2_Trip -> SwcUcv_Prototype.rport_If_sr_Bc2_Trip
    connect SwcAtp_Prototype.pport_If_cs_Atp_TM -> SwcUcv_Prototype.rport_If_cs_Atp_TM
    connect SwcBc_Prototype.pport_If_cs_Bc_TM -> SwcUcv_Prototype.rport_If_cs_Bc_TM
    connect SwcTnk_Prototype.pport_If_cs_Tnk_TM -> SwcUcv_Prototype.rport_If_cs_Tnk_TM
    connect CddVMon_Prototype.pport_If_cs_VMon_TM -> SwcUcv_Prototype.rport_If_cs_VMon_TM
    connect SwcCcm_Prototype.pport_If_cs_Cc_TM -> SwcUcv_Prototype.rport_If_cs_Cc_TM
    connect SwcUcv_Prototype.pport_If_sr_Ucv_HmiGaugeValues -> SPD_Prototype.rport_If_sr_Ucv_HmiGaugeValues
    connect SwcUcv_Prototype.pport_If_sr_Ucv_HmiGaugeValues -> SwcBc_Prototype.rport_If_sr_Ucv_HmiGaugeValues
    connect CddErm_Prototype.pport_If_sr_Erm_Rx_Frame_DISP_RPM_PT -> SwcUcv_Prototype.rport_If_sr_Erm_Rx_Frame_DISP_RPM_PT
    connect CddErm_Prototype.pport_If_sr_Erm_Rx_Frame_ST_COSP_FU_ENG -> SwcUcv_Prototype.rport_If_sr_Erm_Rx_Frame_ST_COSP_FU_ENG
    connect CddErm_Prototype.pport_If_cs_Erm -> SwcUcv_Prototype.rport_If_cs_Erm
    connect SwcBc_Prototype.pport_If_sr_Bc_Eco -> SwcUcv_Prototype.rport_If_sr_Bc_Eco
    connect SPD_Prototype.pport_If_sr_Speed -> SwcUcv_Prototype.rport_If_sr_Speed
    connect SwcUcv_Prototype.pport_If_sr_Ucv_Speed -> SwcBc_Prototype.rport_If_sr_Ucv_Speed
    connect CddErm_Prototype.pport_If_sr_Erm_Rx_Frame_RCOG_TRSG -> SwcUcv_Prototype.rport_If_sr_Erm_Rx_Frame_RCOG_TRSG
    connect CddErm_Prototype.pport_If_sr_Erm_Rx_Frame_DISP_CON_HYB -> SwcUcv_Prototype.rport_If_sr_Erm_Rx_Frame_DISP_CON_HYB
    connect SwcBc_Prototype.pport_If_sr_BcFlags -> SwcUcv_Prototype.rport_If_sr_BcFlags
    connect CddErm_Prototype.pport_If_sr_Erm_Rx_Frame_CON_VEH -> SwcUcv_Prototype.rport_If_sr_Erm_Rx_Frame_CON_VEH
    connect SwcBc_Prototype.pport_If_sr_Bc_CanMsgDtKi -> SwcUcv_Prototype.rport_If_sr_Bc_CanMsgDtKi
    connect SwcGear_Prototype.pport_If_sr_GearData -> SwcUcv_Prototype.rport_If_sr_Gear
    connect SPD_Prototype.pport_If_sr_Speed -> SwcGear_Prototype.rport_If_sr_Speed
    connect CddErm_Prototype.pport_If_sr_Erm_Rx_Frame_DT_DISP_GRDT -> SwcGear_Prototype.rport_If_sr_Erm_Rx_Frame_DT_DISP_GRDT
    connect CddErm_Prototype.pport_If_sr_Erm_Rx_Frame_DISP_RPM_PT -> SwcGear_Prototype.rport_If_sr_Erm_Rx_Frame_DISP_RPM_PT
    connect CddErm_Prototype.pport_If_sr_Erm_Rx_Frame_CON_VEH -> SwcGear_Prototype.rport_If_sr_Erm_Rx_Frame_CON_VEH
    connect CddErm_Prototype.pport_If_cs_Erm -> SwcGear_Prototype.rport_If_cs_Erm
    connect CddErm_Prototype.pport_If_cs_Erm -> CddVMon_Prototype.rport_If_cs_Erm
    connect SwcAtp_Prototype.pport_If_sr_Atp -> SwcBc_Prototype.rport_If_sr_Atp
    connect CddErm_Prototype.pport_If_sr_Erm_Rx_Frame_DT_PT_2 -> SwcAtp_Prototype.rport_If_sr_Erm_Rx_Frame_DT_PT_2
    connect SPD_Prototype.pport_If_sr_Speed -> SwcAtp_Prototype.rport_If_sr_Speed
    connect SwcOdo_Prototype.pport_If_sr_Odo -> SwcCcm_Prototype.rport_If_sr_Odo
    connect SwcOdo_Prototype.pport_If_sr_Odo -> SwcBc_Prototype.rport_If_sr_Odo
    connect CddErm_Prototype.pport_If_cs_Erm -> SwcOdo_Prototype.rport_If_cs_Erm
    connect CddErm_Prototype.pport_If_sr_Erm_Rx_Frame_MILE_VEH -> SwcOdo_Prototype.rport_If_sr_Erm_Rx_Frame_MILE_VEH
    connect SPD_Prototype.pport_If_sr_Speed -> SwcOdo_Prototype.rport_If_sr_Speed
    connect SwcCcm_Prototype.pport_If_cs_Ccm_GetDisplayedCCID -> SwcBc_Prototype.rport_If_cs_Ccm_GetDisplayedCCID
    connect SwcCcm_Prototype.pport_If_cs_Ccm_SetClrMessage -> CddErm_Prototype.rport_If_cs_Ccm_SetClrMessage
    connect SwcCcm_Prototype.pport_If_cs_Ccm_CanCallback -> CddErm_Prototype.rport_If_cs_Ccm_CanCallback
    connect CddErm_Prototype.pport_If_cs_Erm -> SwcCcm_Prototype.rport_If_cs_Erm
    connect SPD_Prototype.pport_If_sr_Speed -> SwcCcm_Prototype.rport_If_sr_Speed
    connect SwcKlb_Prototype.pport_If_cs_Ccm_LampStatus_To_Klb -> SwcCcm_Prototype.rport_If_cs_Ccm_LampStatus_To_Klb
    connect CddErm_Prototype.pport_If_sr_Erm_Rx_Frame_ST_RCP -> SwcCcm_Prototype.rport_If_sr_Erm_Rx_Frame_ST_RCP
    connect SwcTnk_Prototype.pport_If_sr_Tnk -> SwcBc_Prototype.rport_If_sr_Tnk
    connect CddErm_Prototype.pport_If_sr_Erm_Rx_Frame_RAW_DATA_TANK -> SwcTnk_Prototype.rport_If_sr_Erm_Rx_Frame_RAW_DATA_TANK
    connect CddErm_Prototype.pport_If_sr_Erm_Rx_Frame_ST_COSP_FU_ENG -> SwcTnk_Prototype.rport_If_sr_Erm_Rx_Frame_ST_COSP_FU_ENG
    connect CddErm_Prototype.pport_If_cs_Erm -> SwcTnk_Prototype.rport_If_cs_Erm
    connect SPD_Prototype.pport_If_sr_Speed -> SwcTnk_Prototype.rport_If_sr_Speed
    connect CddErm_Prototype.pport_If_sr_Erm_Rx_Frame_ACLNX_MASSCNTR -> SwcTnk_Prototype.rport_If_sr_Erm_Rx_Frame_ACLNX_MASSCNTR
    connect CddErm_Prototype.pport_If_sr_Erm_Rx_Frame_ACLNY_MASSCNTR -> SwcTnk_Prototype.rport_If_sr_Erm_Rx_Frame_ACLNY_MASSCNTR
    connect CddErm_Prototype.pport_If_sr_Erm_Rx_Frame_TLT_RW -> SwcTnk_Prototype.rport_If_sr_Erm_Rx_Frame_TLT_RW
    connect CddErm_Prototype.pport_If_sr_Erm_Rx_Frame_DISP_DT_HVSTO -> SwcTnk_Prototype.rport_If_sr_Erm_Rx_Frame_DISP_DT_HVSTO
    connect CddErm_Prototype.pport_If_sr_Erm_Rx_Frame_DISP_CON_HYB -> SwcTnk_Prototype.rport_If_sr_Erm_Rx_Frame_DISP_CON_HYB
    connect SwcBc_Prototype.pport_If_sr_Bc_Range -> SwcTnk_Prototype.rport_If_sr_Bc_Range
    connect CddErm_Prototype.pport_If_cs_Erm -> SwcKlb_Prototype.rport_If_cs_Erm
    connect CddErm_Prototype.pport_If_cs_Erm -> SwcBc_Prototype.rport_If_cs_Erm
    connect CddErm_Prototype.pport_If_sr_Erm_Rx_Frame_ST_CENG -> SwcKlb_Prototype.rport_If_sr_Erm_Rx_Frame_ST_CENG
    connect CddErm_Prototype.pport_If_sr_Erm_Rx_Frame_ST_CENG -> SwcBc_Prototype.rport_If_sr_Erm_Rx_Frame_ST_CENG
    connect CddErm_Prototype.pport_If_sr_Erm_Rx_Frame_DISP_COSA_HYB -> SwcBc_Prototype.rport_If_sr_Erm_Rx_Frame_DISP_COSA_HYB
    connect CddErm_Prototype.pport_If_sr_Erm_Rx_Frame_DT_DISP_GRDT -> SwcBc_Prototype.rport_If_sr_Erm_Rx_Frame_DT_DISP_GRDT
    connect CddErm_Prototype.pport_If_sr_Erm_Rx_Frame_DT_PT_2 -> SwcBc_Prototype.rport_If_sr_Erm_Rx_Frame_DT_PT_2
    connect CddErm_Prototype.pport_If_sr_Erm_Rx_Frame_CHGNG_ST -> SwcBc_Prototype.rport_If_sr_Erm_Rx_Frame_CHGNG_ST
    connect CddErm_Prototype.pport_If_sr_Erm_Rx_Frame_DXP_MOD -> SwcBc_Prototype.rport_If_sr_Erm_Rx_Frame_DXP_MOD
    connect CddErm_Prototype.pport_If_sr_Erm_Rx_Frame_ST_CHGINTF -> SwcBc_Prototype.rport_If_sr_Erm_Rx_Frame_ST_CHGINTF
    connect CddErm_Prototype.pport_If_sr_Erm_Rx_Frame_DISP_CON_HYB -> SwcBc_Prototype.rport_If_sr_Erm_Rx_Frame_DISP_CON_HYB
    connect CddErm_Prototype.pport_If_sr_Erm_Rx_Frame_ST_MAB_ASST -> SwcKlb_Prototype.rport_If_sr_Erm_Rx_Frame_ST_MAB_ASST
    connect CddErm_Prototype.pport_If_sr_Erm_Rx_Frame_DT_RNG_CALC -> SwcBc_Prototype.rport_If_sr_Erm_Rx_Frame_DT_RNG_CALC
    connect CddErm_Prototype.pport_If_sr_Erm_Rx_Frame_SYS_ST_EVEH_DRV -> SwcBc_Prototype.rport_If_sr_Erm_Rx_Frame_SYS_ST_EVEH_DRV
    connect CddErm_Prototype.pport_If_sr_Erm_Rx_Frame_CHGNG_ST_2 -> SwcBc_Prototype.rport_If_sr_Erm_Rx_Frame_CHGNG_ST_2
    connect CddErm_Prototype.pport_If_sr_Erm_Rx_Frame_ST_COSP_FU_ENG -> SwcBc_Prototype.rport_If_sr_Erm_Rx_Frame_ST_COSP_FU_ENG
    connect CddErm_Prototype.pport_If_sr_Erm_Rx_Frame_MILE_VEH -> SwcBc_Prototype.rport_If_sr_Erm_Rx_Frame_MILE_VEH
    connect CddErm_Prototype.pport_If_sr_Erm_Rx_Frame_DISP_PWR_DRV -> SwcBc_Prototype.rport_If_sr_Erm_Rx_Frame_DISP_PWR_DRV
    connect CddErm_Prototype.pport_If_sr_Erm_Rx_Frame_DISP_FRSG -> SwcBc_Prototype.rport_If_sr_Erm_Rx_Frame_DISP_FRSG
    connect CddErm_Prototype.pport_If_sr_Erm_Rx_Frame_AVL_RPM_WHL_UPRT -> SwcBc_Prototype.rport_If_sr_Erm_Rx_Frame_AVL_RPM_WHL_UPRT
    connect CddErm_Prototype.pport_If_sr_Erm_Rx_Frame_LAMPENZUSTAND -> SwcKlb_Prototype.rport_If_sr_Erm_Rx_Frame_LAMPENZUSTAND
    connect CddErm_Prototype.pport_If_sr_Erm_Rx_Frame_DT_RNG_CALC_2 -> SwcBc_Prototype.rport_If_sr_Erm_Rx_Frame_DT_RNG_CALC_2
    connect CddErm_Prototype.pport_If_sr_Erm_Rx_Frame_RQ_AIC_1 -> SwcBc_Prototype.rport_If_sr_Erm_Rx_Frame_RQ_AIC_1
    connect CddErm_Prototype.pport_If_sr_Erm_Rx_Frame_BLINKEN -> SwcKlb_Prototype.rport_If_sr_Erm_Rx_Frame_BLINKEN
    connect CddErm_Prototype.pport_If_sr_Erm_Rx_Frame_V_VEH -> SPD_Prototype.rport_If_sr_Erm_Rx_Frame_V_VEH
    connect CddErm_Prototype.pport_If_sr_Erm_Rx_Frame_ST_STAB_DSC -> SwcBc_Prototype.rport_If_sr_Erm_Rx_Frame_ST_STAB_DSC
    connect CddErm_Prototype.pport_If_sr_Erm_Rx_Frame_TLT_RW -> SwcBc_Prototype.rport_If_sr_Erm_Rx_Frame_TLT_RW
    connect CddErm_Prototype.pport_If_sr_Erm_Rx_Frame_DISP_RPM_PT -> SwcBc_Prototype.rport_If_sr_Erm_Rx_Frame_DISP_RPM_PT
    connect CddErm_Prototype.pport_If_sr_Erm_Rx_Frame_ANG_ACPD -> SwcBc_Prototype.rport_If_sr_Erm_Rx_Frame_ANG_ACPD
    connect CddErm_Prototype.pport_If_sr_Erm_Rx_Frame_TORQ_CRSH_1 -> SwcBc_Prototype.rport_If_sr_Erm_Rx_Frame_TORQ_CRSH_1
    connect CddErm_Prototype.pport_If_sr_Erm_Rx_Frame_WMOM_DRV_1 -> SwcBc_Prototype.rport_If_sr_Erm_Rx_Frame_WMOM_DRV_1
    connect CddErm_Prototype.pport_If_sr_Erm_Rx_Frame_CON_VEH -> SPD_Prototype.rport_If_sr_Erm_Rx_Frame_CON_VEH
    connect CddErm_Prototype.pport_If_sr_Erm_Rx_Frame_CON_VEH -> SwcKlb_Prototype.rport_If_sr_Erm_Rx_Frame_CON_VEH
    connect CddErm_Prototype.pport_If_sr_Erm_Rx_Frame_CON_VEH -> SwcBc_Prototype.rport_If_sr_Erm_Rx_Frame_CON_VEH
    connect CddErm_Prototype.pport_If_sr_Erm_Rx_Frame_DISP_DT_HVSTO -> SwcBc_Prototype.rport_If_sr_Erm_Rx_Frame_DISP_DT_HVSTO
    connect SwcKlb_Prototype.pport_If_cs_Klb_Callback -> CddErm_Prototype.rport_If_cs_Klb_Callback
    connect CddErm_Prototype.pport_If_sr_Erm_Rx_Frame_CTR_FN_IDC -> SwcKlb_Prototype.rport_If_sr_Erm_Rx_Frame_CTR_FN_IDC
    connect CddErm_Prototype.pport_If_sr_Erm_Rx_Frame_ST_OP_LP_EX -> SwcKlb_Prototype.rport_If_sr_Erm_Rx_Frame_ST_OP_LP_EX
    connect CddErm_Prototype.pport_If_sr_Erm_Rx_Frame_DISP_SW_DRDY_TECGY_EXPI -> SwcBc_Prototype.rport_If_sr_Erm_Rx_Frame_DISP_SW_DRDY_TECGY_EXPI
    connect CddErm_Prototype.pport_If_sr_Erm_Rx_Frame_CTR_IDLIS -> SwcKlb_Prototype.rport_If_sr_Erm_Rx_Frame_CTR_IDLIS
    connect SPD_Prototype.pport_If_sr_Speed -> SwcKlb_Prototype.rport_If_sr_Speed
    connect SPD_Prototype.pport_If_sr_Speed -> SwcBc_Prototype.rport_If_sr_Speed
    connect PiaWrp_Prototype.BcContentConfigurationPart1 -> PiaClient.BcContentConfigurationPart1
    connect PiaWrp_Prototype.ClusterBrightnessOffset -> PiaClient.ClusterBrightnessOffset
    connect PiaWrp_Prototype.ClusterDisplayConfiguration -> PiaClient.ClusterDisplayConfiguration
    connect PiaWrp_Prototype.DateFormat -> PiaClient.DateFormat
    connect PiaWrp_Prototype.DistanceUnit -> PiaClient.DistanceUnit
    connect PiaWrp_Prototype.ElectricConsumption -> PiaClient.ElectricConsumption
    connect PiaWrp_Prototype.FesSelection -> PiaClient.FesSelection
    connect PiaWrp_Prototype.FuelConsumption -> PiaClient.FuelConsumption
    connect PiaWrp_Prototype.FuelUnit -> PiaClient.FuelUnit
    connect PiaWrp_Prototype.Language -> PiaClient.Language
    connect PiaWrp_Prototype.LastBcEntry -> PiaClient.LastBcEntry
    connect PiaWrp_Prototype.PowerTorqueUnit -> PiaClient.PowerTorqueUnit
    connect PiaWrp_Prototype.PresetConfiguration -> PiaClient.PresetConfiguration
    connect PiaWrp_Prototype.PreassureUnit -> PiaClient.PressureUnit
    connect PiaWrp_Prototype.TemperatureUnit -> PiaClient.TemperatureUnit
    connect PiaWrp_Prototype.TimeFormat -> PiaClient.TimeFormat
    connect PiaClient.PiaApplMakePersistent -> PiaWrp_Prototype.PiaClient_MakePersistent
    connect PiaClient.PiaFunctionUpdateValue_BcContentConfigurationPart1 -> PiaWrp_Prototype.PiaClient_UpdateValue_BcContentConfigurationPart1
    connect PiaClient.PiaFunctionUpdateValue_ClusterBrightnessOffset -> PiaWrp_Prototype.PiaClient_UpdateValue_ClusterBrightnessOffset
    connect PiaClient.PiaFunctionUpdateValue_ClusterDisplayConfiguration -> PiaWrp_Prototype.PiaClient_UpdateValue_ClusterDisplayConfiguration
    connect PiaClient.PiaFunctionUpdateValue_DateFormat -> PiaWrp_Prototype.PiaClient_UpdateValue_DateFormat
    connect PiaClient.PiaFunctionUpdateValue_DistanceUnit -> PiaWrp_Prototype.PiaClient_UpdateValue_DistanceUnit
    connect PiaClient.PiaFunctionUpdateValue_ElectricConsumption -> PiaWrp_Prototype.PiaClient_UpdateValue_ElectricConsumption
    connect PiaClient.PiaFunctionUpdateValue_FesSelection -> PiaWrp_Prototype.PiaClient_UpdateValue_FesSelection
    connect PiaClient.PiaFunctionUpdateValue_FuelConsumption -> PiaWrp_Prototype.PiaClient_UpdateValue_FuelConsumption
    connect PiaClient.PiaFunctionUpdateValue_FuelUnit -> PiaWrp_Prototype.PiaClient_UpdateValue_FuelUnit
    connect PiaClient.PiaFunctionUpdateValue_Language -> PiaWrp_Prototype.PiaClient_UpdateValue_Language
    connect PiaClient.PiaFunctionUpdateValue_LastBcEntry -> PiaWrp_Prototype.PiaClient_UpdateValue_LastBcEntry
    connect PiaClient.PiaFunctionUpdateValue_PowerTorqueUnit -> PiaWrp_Prototype.PiaClient_UpdateValue_PowerTorqueUnit
    connect PiaClient.PiaFunctionUpdateValue_PresetConfiguration -> PiaWrp_Prototype.PiaClient_UpdateValue_PresetConfiguration
    connect PiaClient.PiaFunctionUpdateValue_PressureUnit -> PiaWrp_Prototype.PiaClient_UpdateValue_PreassureUnit
    connect PiaClient.PiaFunctionUpdateValue_TemperatureUnit -> PiaWrp_Prototype.PiaClient_UpdateValue_TemperatureUnit
    connect PiaClient.PiaFunctionUpdateValue_TimeFormat -> PiaWrp_Prototype.PiaClient_UpdateValue_TimeFormat
    connect PiaWrp_Prototype.pport_If_sr_PIA_ProfileData -> SwcUcv_Prototype.rport_If_PIA_ProfileData
    connect PiaWrp_Prototype.pport_If_sr_PIA_ProfileData -> SwcGear_Prototype.rport_If_PIA_ProfileData
    connect CddErm_Prototype.pport_If_cs_Erm -> PiaWrp_Prototype.rport_If_cs_Erm
    connect CddErm_Prototype.pport_If_sr_Erm_Rx_Frame_DXP_MOD -> PiaWrp_Prototype.rport_If_sr_Erm_Rx_Frame_DXP_MOD
    connect CddErm_Prototype.pport_If_sr_Erm_Rx_Frame_DISP_FRSG -> PiaWrp_Prototype.rport_If_sr_Erm_Rx_Frame_DISP_FRSG
    connect CddErm_Prototype.pport_If_sr_Erm_Rx_Frame_CON_VEH -> PiaWrp_Prototype.rport_If_sr_Erm_Rx_Frame_CON_VEH
    connect PiaWrp_Prototype.pport_If_sr_PIA_ProfileData -> SwcBc_Prototype.rport_If_PIA_ProfileData
    connect PiaWrp_Prototype.pport_If_sr_PIA_ProfileData -> PiaWrp_Prototype.rport_If_sr_PIA_ProfileData
    connect Det.DS_AC_SAFM -> AC_SAFM_Prototype.DETService_ACSAFM
    connect CDDBIF_Prototype.pport_If_cs_AnyToBif -> SecM.rport_If_cs_SecMToBif
    connect SwcUcv_Prototype.pport_If_sr_BordcomputerAverage -> HMIIF_Prototype.rport_If_sr_BordcomputerAverage
    connect SwcUcv_Prototype.pport_If_sr_Odo_To_AuthHandlerGSSProxy -> HMIIF_Prototype.rport_If_sr_Odo_To_AuthHandlerGSSProxy
    connect SwcTnk_Prototype.pport_If_sr_Tnk -> HMIIF_Prototype.rport_If_sr_Tnk
    connect CddErm_Prototype.pport_If_sr_Erm_Rx_Frame_DISP_CON_HYB -> HMIIF_Prototype.rport_If_sr_Erm_Rx_Frame_DISP_CON_HYB
    connect CddErm_Prototype.pport_If_sr_Erm_Rx_Frame_SYS_ST_EVEH_DRV -> HMIIF_Prototype.rport_If_sr_Erm_Rx_Frame_SYS_ST_EVEH_DRV
    connect CddErm_Prototype.pport_If_sr_Erm_Rx_Frame_ST_COSP_FU_ENG -> HMIIF_Prototype.rport_If_sr_Erm_Rx_Frame_ST_COSP_FU_ENG
    connect CddErm_Prototype.pport_If_sr_Erm_Rx_Frame_DISP_PWR_DRV -> HMIIF_Prototype.rport_If_sr_Erm_Rx_Frame_DISP_PWR_DRV
    connect CddErm_Prototype.pport_If_sr_Erm_Rx_Frame_DISP_RPM_PT -> HMIIF_Prototype.rport_If_sr_Erm_Rx_Frame_DISP_RPM_PT
    connect CddErm_Prototype.pport_If_sr_Erm_Rx_Frame_CON_VEH -> HMIIF_Prototype.rport_If_sr_Erm_Rx_Frame_CON_VEH
    connect SwcBc_Prototype.pport_If_sr_Bc_ConsumptionHistory2 -> HMIIF_Prototype.rport_If_sr_Bc_ConsumptionHistory2
    connect PiaWrp_Prototype.pport_If_sr_PIA_ProfileData -> HMIIF_Prototype.rport_If_PIA_ProfileData
    connect SwcElc_Prototype.pport_If_sr_Elc_PowermeterCoding -> HMIIF_Prototype.rport_If_sr_Elc_PowermeterCoding
    connect SwcRda_Prototype.pport_If_sr_Rda -> HMIIF_Prototype.rport_If_sr_Rda
    connect CDD_AMM_Prototype.pport_If_cs_BifToAMM -> CDDBIF_Prototype.rport_If_cs_BifToAMM
    connect CddErm_Prototype.pport_If_sr_Erm_Rx_Frame_RawDataTempEx -> SwcAtp_Prototype.rport_If_sr_Erm_Rx_Frame_RawDataTempEx
    connect SwcKsm_Prototype.PPort_If_sr_System -> SwcAtp_Prototype.rport_If_sr_System
    connect SwcCDBus_Prototype.pport_If_cs_CDBus -> SwcKsm_Prototype.rport_If_cs_CDBus
    connect SwcAtp_Prototype.pport_If_cs_FubiStd -> SwcKsm_Prototype.RPort_If_cs_FubiStd_Atp
    connect SwcCcm_Prototype.pport_If_cs_FubiStd -> SwcKsm_Prototype.RPort_If_cs_FubiStd_Ccm
    connect SwcTnk_Prototype.pport_If_cs_FubiStd -> SwcKsm_Prototype.RPort_If_cs_FubiStd_Tnk
    connect CddErm_Prototype.pport_If_sr_Erm_Rx_Frame_ST_CENG -> SwcKsm_Prototype.RPort_If_sr_Erm_Rx_Frame_ST_CENG
    connect CddErm_Prototype.pport_If_sr_Erm_Rx_Frame_DISP_CON_HYB -> SwcKsm_Prototype.rport_If_sr_Erm_Rx_Frame_DISP_CON_HYB
    connect CddErm_Prototype.pport_If_sr_Erm_Rx_Frame_STAT_ENG_STA_AUTO -> SwcKsm_Prototype.rport_If_sr_Erm_Rx_Frame_STAT_ENG_STA_AUTO
    connect CddErm_Prototype.pport_If_sr_Erm_Rx_Frame_SYS_ST_EVEH_DRV -> SwcKsm_Prototype.rport_If_sr_Erm_Rx_Frame_SYS_ST_EVEH_DRV
    connect CddErm_Prototype.pport_If_sr_Erm_Rx_Frame_V_VEH -> SwcKsm_Prototype.RPort_If_sr_Erm_Rx_Frame_V_VEH
    connect CddErm_Prototype.pport_If_sr_Erm_Rx_Frame_CON_VEH -> SwcKsm_Prototype.RPort_If_sr_Erm_Rx_Frame_CON_VEH
    connect CddErm_Prototype.pport_If_sr_Erm_Rx_Frame_STAT_ZV_KLAPPEN -> SwcKsm_Prototype.RPort_If_sr_Erm_Rx_Frame_STAT_ZV_KLAPPEN
    connect SwcKlb_Prototype.pport_If_cs_Klb -> SwcKsm_Prototype.RPort_If_cs_Klb
    connect HMIIF_Prototype.pport_If_sr_SwcKsm_Hmi_RequestGeneral -> SwcKsm_Prototype.rport_If_sr_SwcKsm_Hmi_RequestGeneral
    connect PiaWrp_Prototype.pport_If_sr_PIA_ProfileData -> SwcKsm_Prototype.rport_If_sr_Pia_ProfileData
    connect SwcKsm_Prototype.PPort_If_sr_System -> SwcCcm_Prototype.rport_If_sr_System
    connect SwcKsm_Prototype.PPort_If_sr_System -> SwcTnk_Prototype.rport_If_sr_System
    connect SwcKsm_Prototype.PPort_If_sr_System -> SwcBc_Prototype.rport_If_sr_System
    connect SwcTnk_Prototype.pport_If_sr_Tnk -> SwcBcWrp_Prototype.rport_If_sr_Tnk
    connect SwcBc_Prototype.pport_If_sr_Bc_Range -> SwcBcWrp_Prototype.rport_If_sr_Bc_Range
    connect DiagAppl.PPort_If_RoutineServices_ActivateActivationLine -> DcmInstance.RoutineServices_ActivateActivationLine
    connect DiagAppl.PPort_If_DataServices_DcmDspData_DisplayedMileage -> DcmInstance.DataServices_DcmDspData_DisplayedMileage
    connect DiagAppl.PPort_If_DataServices_DcmDspData_ReadOnboardSystemVoltage -> DcmInstance.DataServices_DcmDspData_ReadOnboardSystemVoltage
    connect CddVMon_Prototype.pport_If_cs_VMon_Diag -> DiagAppl.RPort_if_cs_VMon_Diag
    connect SwcOdo_Prototype.pport_If_cs_Odo_Diag -> DiagAppl.RPort_If_cs_Odo_Diag
    connect SwcCcm_Prototype.pport_If_cs_Ccm_Diag -> DiagAppl.RPort_if_cs_Ccm_Diag
    connect SwcKsm_Prototype.PPort_If_sr_System -> SwcKlb_Prototype.rport_If_sr_System
    connect CddSwcDfe_Prototype.pport_If_sr_Dfe_Status -> SwcKlb_Prototype.rport_If_sr_Dfe_Status
    connect SwcKsm_Prototype.PPort_If_sr_System -> SwcGear_Prototype.rport_If_sr_System
    connect SwcCcm_Prototype.pport_If_cs_Ccm_Msg_Cbk -> SwcCcmWrp_Prototype.rport_If_cs_Ccm_Msg_Cbk
    connect SwcCcmWrp_Prototype.pport_If_cs_Ccm_Msg -> SwcCcm_Prototype.rport_If_cs_Ccm_Msg
    connect CddErm_Prototype.pport_If_sr_Erm_Rx_Frame_STAT_KLIMA_STAND -> SwcKlb_Prototype.rport_If_sr_Erm_Rx_Frame_STAT_KLIMA_STAND
    connect SwcCcmWrp_Prototype.pport_If_sr_CcmToHmi -> HMIIF_Prototype.rport_If_sr_CcmToHmi
    connect SwcTST_Prototype.pport_If_cs_General_TM -> SwcUcv_Prototype.rport_If_cs_General_TM
    connect SwcUcv_Prototype.pport_If_sr_Ucv_HmiGaugeValues -> SwcTST_Prototype.rport_If_sr_Tch
    connect SwcUcv_Prototype.pport_If_sr_Ucv_Speed -> SwcTST_Prototype.rport_If_sr_Ucv_Speed
    connect CddErm_Prototype.pport_If_sr_Erm_Rx_Frame_CHNO_COV_V -> SwcTST_Prototype.rport_If_sr_Erm_Rx_Frame_CHNO_V_VEH_COG
    connect CddErm_Prototype.pport_If_sr_Erm_Rx_Frame_DIMMUNG -> SwcTST_Prototype.rport_If_sr_Erm_Rx_Frame_DIMMUNG
    connect CddErm_Prototype.pport_If_sr_Erm_Rx_Frame_CON_VEH -> SwcTST_Prototype.rport_If_sr_Erm_Rx_Frame_CON_VEH
    connect HMIIF_Prototype.pport_If_cs_Klb_To_Hardware -> SwcTST_Prototype.rport_If_cs_Klb_To_Hardware
    connect HMIIF_Prototype.pport_If_sr_SwcKsm_Hmi_RequestGeneral -> SwcTST_Prototype.rport_If_sr_Hmi_RequestGeneral
    connect SPD_Prototype.pport_If_sr_Speed -> SwcTST_Prototype.rport_If_sr_Speed
    connect SwcDim_Prototype.pport_If_sr_Dim -> SwcTST_Prototype.rport_If_sr_Dim
    connect SwcLdm_Prototype.pport_If_sr_Ldm_CruiseControl -> SwcTST_Prototype.rport_If_sr_Ldm_CruiseControl
    connect SwcKsm_Prototype.PPort_If_sr_System -> SwcTST_Prototype.rport_If_sr_System
    connect SwcDimWrp_Prototype.pport_If_sr_Dim_Photocell -> SwcTST_Prototype.rport_If_sr_Dim_Photocell
    connect SwcTST_Prototype.pport_If_sr_Tst_Cc -> SwcCcmWrp_Prototype.rport_If_sr_Tst_SelfTestMode
    connect DiagAppl.PPort_If_DataServices_DcmDspData_Dimmwert -> DcmInstance.DataServices_DcmDspData_Dimmwert
    connect DiagAppl.PPort_If_DataServices_DcmDspData_StatusGwszAbsolut -> DcmInstance.DataServices_DcmDspData_GwszAbsolutWert
    connect DiagAppl.PPort_If_DataServices_DcmDspData_StatusGwszDisplayed -> DcmInstance.DataServices_DcmDspData_GwszAnzeigeWert
    connect DiagAppl.PPort_If_DataServices_DcmDspData_SetTimeAndDate -> DcmInstance.DataServices_DcmDspData_KombiUhrzeitDatum
    connect DiagAppl.PPort_If_DataServices_DcmDspData_ReadSensorIdent01 -> DcmInstance.DataServices_DcmDspData_Sensor1
    connect DiagAppl.PPort_If_DataServices_DcmDspData_RelativeTimeCounterMaster -> DcmInstance.DataServices_DcmDspData_StatusSystime
    connect DiagAppl.PPort_If_RoutineServices_ActivateZgwApplicationMode_Routine -> DcmInstance.RoutineServices_ActivateZgwApplicationmode
    connect DiagAppl.PPort_If_RoutineServices_ActivateZgwFlashMode_Routine -> DcmInstance.RoutineServices_ActivateZgwFlashmode
    connect DiagAppl.PPort_If_RoutineServices_ClearDiagBuffer -> DcmInstance.RoutineServices_CcMeldungsspeicherLoeschen
    connect DiagAppl.PPort_if_RoutineServices_ControlSelfTest -> DcmInstance.RoutineServices_Selbsttest
    connect SwcDim_Prototype.pport_If_cs_Dim_Diag -> DiagAppl.RPort_If_cs_Dim_Diag
    connect Bs.FieldMode -> DcmInstance.RoutineServices_FallbackFieldMode
    connect Bs.SfaVerifyToken -> DcmInstance.RoutineServices_SfaVerifyToken
    connect Coding.CheckNCD -> DcmInstance.RoutineServices_CheckNcd
    connect Omc.ControlExtendedEnergySavingState -> DcmInstance.RoutineServices_ControlExtendedEnergySavingState
    connect Darh.DmClientTriggerDtcEntry -> DcmInstance.RoutineServices_DmClientTriggerDtcEntry
    connect Omc.ControlEnergySavingState -> DcmInstance.RoutineServices_Energiesparmode
    connect StdDiag.ClearSecondaryErrorMemory -> DcmInstance.RoutineServices_IsLoeschen
    connect Dlog.DevelopmentInfoField -> DcmInstance.RoutineServices_RcRswedi
    connect SwcTmm_Prototype.pport_If_cs_Tmm_Diag -> DiagAppl.RPort_If_cs_Tmm_Diag
    connect NvM.PS_NvM_Block_ODO_INCREMENTAL -> SwcOdoWrp_Prototype.rport_cl_Service_NVM_ODO_INCREMENTAL
    connect NvM.PS_NvM_Block_ODO_TEMPORARY -> SwcOdoWrp_Prototype.rport_cl_Service_NVM_ODO_TEMPORARY
    connect SwcOdoWrp_Prototype.pport_cl_NotifyJobFinished_NVM_ODO_BLOCKS -> NvM.PNJobFinished_NvM_Block_ODO_INCREMENTAL
    connect SwcOdoWrp_Prototype.pport_cl_NotifyJobFinished_NVM_ODO_BLOCKS_TEMPORARY -> NvM.PNJobFinished_NvM_Block_ODO_TEMPORARY
    connect SwcOdo_Prototype.pport_If_sr_Odo -> SwcOdoWrp_Prototype.rport_If_sr_Odo
    connect SwcCbs_Prototype.pport_If_sr_Odo_Limits -> SwcOdo_Prototype.rport_If_sr_Odo_Limits
    connect SwcOdoWrp_Prototype.pport_If_cs_Odo_eep -> SwcOdo_Prototype.rport_If_cs_Odo_eep
    connect SwcKsm_Prototype.PPort_If_sr_System -> SwcOdo_Prototype.rport_If_sr_System
    connect SwcOdoWrp_Prototype.pport_If_sr_Odo_TripLimit -> SwcOdo_Prototype.rport_If_sr_Odo_TripLimit
    connect CddErm_Prototype.pport_If_cs_Erm -> SwcOdoWrp_Prototype.rport_If_cs_Erm
    connect CddErm_Prototype.pport_If_sr_Erm_Rx_Frame_CON_VEH -> SwcOdoWrp_Prototype.rport_If_sr_Erm_Rx_Frame_CON_VEH
    connect PiaWrp_Prototype.pport_If_sr_PIA_ProfileData -> SwcOdoWrp_Prototype.rport_If_PIA_ProfileData
    connect SwcKsm_Prototype.PPort_If_sr_System -> SwcOdoWrp_Prototype.rport_If_sr_System
    connect DiagAppl.PPort_If_cs_DataServices_DcmDspData_ATempWert -> DcmInstance.DataServices_DcmDspData_ATempWert
    connect DiagAppl.PPort_If_cs_DataServices_DcmDspData_BmwCcDatenSaetze -> DcmInstance.DataServices_DcmDspData_BmwCcDatensaetze
    connect DiagAppl.PPort_If_cs_DataServices_DcmDspData_GwszReset -> DcmInstance.DataServices_DcmDspData_GwszReset
    connect DiagAppl.PPort_If_cs_DataServices_DcmDspData_HudSensorenIdenLesenErWeirtert -> DcmInstance.DataServices_DcmDspData_HudSensorenIdentLesenErweitert
    connect DiagAppl.PPort_If_cs_DataServices_DcmDspData_StatusHudBildpositionSchritte -> DcmInstance.DataServices_DcmDspData_StatusHudBildpositionSchritte
    connect DiagAppl.PPort_If_cs_DataServices_DcmDspData_Tankinhalt -> DcmInstance.DataServices_DcmDspData_Tankinhalt
    connect SwcAtp_Prototype.pport_If_cs_Atp_Diag -> DiagAppl.RPort_If_cs_ATempWert
    connect SwcCcm_Prototype.pport_If_cs_Ccm_Diag -> DiagAppl.RPort_If_cs_BmwCcDatenSaetze
    connect SwcTnk_Prototype.pport_If_cs_Tnk_Diag -> DiagAppl.RPort_If_cs_Tankinhalt
    connect SwcCbs_Prototype.pport_If_cs_Cbs_Diag -> DiagAppl.RPort_If_cs_GwszReset
    connect CddErm_Prototype.pport_If_sr_Erm_Rx_Frame_ST_COSP_FU_ENG -> SwcElc_Prototype.rport_If_sr_Erm_Rx_Frame_ST_COSP_FU_ENG
    connect CddErm_Prototype.pport_If_sr_Erm_Rx_Frame_DISP_PWR_DRV -> SwcElc_Prototype.rport_If_sr_Erm_Rx_Frame_DISP_PWR_DRV
    connect CddErm_Prototype.pport_If_sr_Erm_Rx_Frame_CON_VEH -> SwcElc_Prototype.rport_If_sr_Erm_Rx_Frame_CON_VEH
    connect CddErm_Prototype.pport_If_sr_Erm_Rx_Frame_DISP_SW_DRDY_S_2 -> SwcElc_Prototype.rport_If_sr_Erm_Rx_Frame_DISP_SW_DRDY_S_2
    connect CddVMonWrp_Prototype.pport_If_sr_VMonWrp -> CddVMon_Prototype.rport_If_sr_VMonWrp
    connect SwcKsm_Prototype.PPort_If_sr_System -> CddVMon_Prototype.rport_If_sr_System
    connect CddHal_Prototype.pport_If_sr_Adc -> CddVMonWrp_Prototype.rport_If_sr_Adc
    connect SwcCcmWrp_Prototype.pport_If_cs_Ccm_FLamp -> SwcCcm_Prototype.rport_If_cs_Ccm_FLamp
    connect CddErm_Prototype.pport_If_sr_Erm_Rx_Frame_STAT_FAHRLICHT -> SwcDim_Prototype.rport_If_sr_Erm_Rx_Frame_STAT_FAHRLICHT
    connect CddErm_Prototype.pport_If_sr_Erm_Rx_Frame_BRIG_SURR -> SwcDim_Prototype.rport_If_sr_Erm_Rx_Frame_BRIG_SURR
    connect CddErm_Prototype.pport_If_sr_Erm_Rx_Frame_DIMMUNG -> SwcDim_Prototype.rport_If_sr_Erm_Rx_Frame_DIMMUNG
    connect CddErm_Prototype.pport_If_sr_Erm_Rx_Frame_CTR_IDLIS -> SwcDim_Prototype.rport_If_sr_Erm_Rx_Frame_CTR_IDLIS
    connect SwcDim_Prototype.pport_If_sr_Dim -> SwcDimWrp_Prototype.rport_If_sr_Dim
    connect SwcDim_Prototype.pport_If_sr_Dim -> CddSwcDfe_Prototype.rport_If_sr_Dim
    connect CddErm_Prototype.pport_If_sr_Erm_Rx_Frame_BEDIENUNG_UHRZEIT_DATUM -> SwcTmm_Prototype.rport_If_sr_Erm_Rx_Frame_BEDIENUNG_UHRZEIT_DATUM
    connect CddErm_Prototype.pport_If_sr_Erm_Rx_Frame_GPS_CTI_CAN -> SwcTmm_Prototype.rport_If_sr_Erm_Rx_Frame_GPS_CTI_CAN
    connect CddErm_Prototype.pport_If_sr_Erm_Rx_Frame_GPS_DATE_CAN -> SwcTmm_Prototype.rport_If_sr_Erm_Rx_Frame_GPS_DATE_CAN
    connect CddErm_Prototype.pport_If_sr_Erm_Rx_Frame_OP_DATE_WIT_SUT -> SwcTmm_Prototype.rport_If_sr_Erm_Rx_Frame_OP_DATE_WIT_SUT
    connect CddErm_Prototype.pport_If_sr_Erm_Rx_Frame_OP_CTI_DATE_UTC -> SwcTmm_Prototype.rport_If_sr_Erm_Rx_Frame_OP_CTI_DATE_UTC
    connect CddErm_Prototype.pport_If_sr_Erm_Rx_Frame_GPS_DATE_MOST -> SwcTmm_Prototype.rport_If_sr_Erm_Rx_Frame_GPS_DATE_MOST
    connect CddErm_Prototype.pport_If_sr_Erm_Rx_Frame_GPS_CTI_MOST -> SwcTmm_Prototype.rport_If_sr_Erm_Rx_Frame_GPS_CTI_MOST
    connect SwcKsm_Prototype.PPort_If_sr_System -> SwcDim_Prototype.rport_If_sr_System
    connect SwcKsm_Prototype.PPort_If_sr_System -> CddErm_Prototype.rport_If_sr_System
    connect SwcUcv_Prototype.Speed -> HMIIF_Prototype.Speed
    connect SwcUcv_Prototype.General_Signals -> HMIIF_Prototype.General_Signals
    connect SwcKlb_Prototype.Ready_Off_NotReady -> HMIIF_Prototype.Ready_Off_NotReady
    connect SwcElc_Prototype.PowermeterFuBi -> HMIIF_Prototype.PowermeterFuBi
    connect AC_SAFM_Prototype.pport_If_cs_BiftoSafm -> CDDBIF_Prototype.rport_If_cs_BifToSAFM
    connect DiagAppl.PPort_If_cs_DataServices_DcmDspData_CbsData -> DcmInstance.DataServices_DcmDspData_CbsData
    connect DiagAppl.PPort_If_cs_DataServices_DcmDspData_CbsKmProJahr -> DcmInstance.DataServices_DcmDspData_CbsKmProJahr
    connect DiagAppl.PPort_If_DataServices_DcmDspData_CbsServiceAktivierung -> DcmInstance.DataServices_DcmDspData_CbsServiceAktivierung
    connect DiagAppl.PPort_If_cs_DataServices_DcmDspData_HudPortsLesen -> DcmInstance.DataServices_DcmDspData_HudPortsLesen
    connect DiagAppl.PPort_If_cs_DataServices_DcmDspData_HudAktivierung -> DcmInstance.DataServices_DcmDspData_HudAktivierung
    connect DiagAppl.PPort_If_DataServices_DcmDspData_UtcOut -> DcmInstance.DataServices_DcmDspData_UtcOut
    connect DiagAppl.PPort_if_RoutineServices_CbsReset -> DcmInstance.RoutineServices_CbsReset
    connect DiagAppl.PPort_If_RoutineServices_CcMeldungTriggern -> DcmInstance.RoutineServices_CcMeldungTriggern
    connect DiagAppl.PPort_if_RoutineServices_InternalTraceDisableUnconditionalTracing -> DcmInstance.RoutineServices_InternalTraceDisableUnconditionalTracing
    connect DiagAppl.PPort_If_RoutineServices_DcmRamDatenSchreiben -> DcmInstance.RoutineServices_RamDatenSchreiben
    connect SwcTST_Prototype.pport_If_cs_DiagService_SelfTest -> DiagAppl.RPort_If_cs_ControlSelfTest
    connect SwcCbs_Prototype.pport_If_cs_Cbs_Diag -> DiagAppl.RPort_If_Cbs_Diag
    connect SwcCbs_Prototype.pport_If_cs_Cbs_Diag -> DiagAppl.RPort_If_cs_CbsData
    connect SwcCbs_Prototype.pport_If_cs_Cbs_Diag -> DiagAppl.RPort_If_cs_CbsKmProJahr
    connect SwcDimWrp_Prototype.pport_If_cs_Dim_SendLdcTargetLum -> SwcDim_Prototype.rport_If_cs_Dim_SendLdcTargetLum
    connect SwcDimWrp_Prototype.pport_If_cs_Dim_DimmingInteriorIllumination -> SwcDim_Prototype.rport_If_cs_Dim_DimmingInteriorIllumination
    connect SwcDimWrp_Prototype.pport_If_sr_Dim_Photocell -> SwcDim_Prototype.rport_If_sr_Dim_Photocell
    connect CddDfeLld_Prototype.pport_If_sr_Photocell_I2c -> SwcDimWrp_Prototype.rport_If_sr_Photocell_I2c
    connect SwcDimWrp_Prototype.pport_If_sr_Pwm -> CddDfeLld_Prototype.rport_If_sr_Pwm
    connect SwcCbs_Prototype.pport_If_cs_Cbs_NvmData -> SwcUcv_Prototype.rport_If_cs_Cbs_NvmData
    connect SwcOdo_Prototype.pport_If_sr_Odo -> SwcCbs_Prototype.rport_If_sr_Odo
    connect SwcCcm_Prototype.pport_If_cs_Ccm_GetDisplayedCCID -> SwcCcmWrp_Prototype.rport_If_cs_Ccm_GetDisplayedCCID
    connect SwcCcm_Prototype.pport_If_cs_Ccm_GetActiveMessages -> SwcCbs_Prototype.rport_If_cs_Ccm_GetActiveMessages
    connect SwcCcm_Prototype.pport_If_cs_Ccm_GetActiveMessages -> SwcCcmWrp_Prototype.rport_If_cs_Ccm_GetActiveMessages
    connect SwcCcm_Prototype.pport_If_cs_Ccm_GetMessageIterator -> SwcCcmWrp_Prototype.rport_If_cs_Ccm_GetMessageIterator
    connect SwcCcm_Prototype.pport_If_cs_Ccm_SetClrMessage -> SwcCbsWrp_Prototype.rport_If_cs_Ccm_SetClrMessage
    connect SwcCcm_Prototype.pport_If_cs_Ccm_SetClrMessage -> SwcCcmWrp_Prototype.rport_If_cs_Ccm_SetClrMessage
    connect SwcCcmWrp_Prototype.pport_If_cs_Ccm_Roll -> SwcCcm_Prototype.rport_If_cs_Ccm_Roll
    connect CddStub_Prototype.pport_If_sr_Clock -> SwcCcm_Prototype.rport_If_sr_Clock
    connect SwcTmm_Prototype.pport_If_sr_Tmm -> SwcCcm_Prototype.rport_If_sr_Tmm
    connect CddErm_Prototype.pport_If_cs_Erm -> SwcCbs_Prototype.rport_If_cs_Erm
    connect SwcCbs_Prototype.pport_If_cs_Cbs_External -> CddErm_Prototype.rport_If_cs_Cbs_External
    connect CddErm_Prototype.pport_If_sr_Erm_Rx_Frame_RCPT_RQ_KI -> SwcCcmWrp_Prototype.rport_If_sr_Erm_Rx_Frame_RCPT_RQ_KI
    connect CddErm_Prototype.pport_If_sr_Erm_Rx_Frame_STATE_SBIL_PS -> SwcCcmWrp_Prototype.rport_If_sr_Erm_Rx_Frame_STATE_SBIL_PS
    connect CddErm_Prototype.pport_If_sr_Erm_Rx_Frame_STATE_SBIL_DR -> SwcCcmWrp_Prototype.rport_If_sr_Erm_Rx_Frame_STATE_SBIL_DR
    connect CddErm_Prototype.pport_If_sr_Erm_Rx_Frame_TERMIN_CBS -> SwcCbsWrp_Prototype.rport_If_sr_Erm_Rx_Frame_TERMIN_CBS
    connect CddErm_Prototype.pport_If_sr_Erm_Rx_Frame_DT_DISP_GRDT -> SwcCcmWrp_Prototype.rport_If_sr_Erm_Rx_Frame_DT_DISP_GRDT
    connect CddErm_Prototype.pport_If_sr_Erm_Rx_Frame_STAT_GANG_RUECKWAERTS -> SwcCcmWrp_Prototype.rport_If_sr_Erm_Rx_Frame_STAT_GANG_RUECKWAERTS
    connect CddErm_Prototype.pport_If_sr_Erm_Rx_Frame_ST_VEH_TONE -> SwcCcmWrp_Prototype.rport_If_sr_Erm_Rx_Frame_ST_VEH_TONE
    connect CddErm_Prototype.pport_If_sr_Erm_Rx_Frame_STAT_CT_HABR -> SwcCcmWrp_Prototype.rport_If_sr_Erm_Rx_Frame_STAT_CT_HABR
    connect CddErm_Prototype.pport_If_sr_Erm_Rx_Frame_STAT_KLIMA_STAND -> SwcCcmWrp_Prototype.rport_If_sr_CcmWrp_Erm_STAT_KLIMA_STAND
    connect CddErm_Prototype.pport_If_sr_Erm_Rx_Frame_ST_BLT_CT_SOCCU -> SwcCcmWrp_Prototype.rport_If_sr_Erm_Rx_Frame_ST_BLT_CT_SOCCU
    connect CddErm_Prototype.pport_If_sr_Erm_Rx_Frame_V_VEH -> SwcCcmWrp_Prototype.rport_If_sr_Erm_Rx_Frame_V_VEH
    connect CddErm_Prototype.pport_If_sr_Erm_Rx_Frame_STAT_SERV_C_TELEX -> SwcCbsWrp_Prototype.rport_If_sr_Erm_Rx_Frame_STAT_SERV_C_TELEX
    connect CddErm_Prototype.pport_If_sr_Erm_Rx_Frame_ST_DISP_BLTW -> SwcCcmWrp_Prototype.rport_If_sr_CcmWrp_Erm_ST_DISP_BLTW
    connect SwcCbs_Prototype.pport_If_cs_Cbs_NvmData -> SwcBc_Prototype.rport_If_cs_Cbs_NvmData
    connect SPD_Prototype.pport_If_sr_Speed -> SwcCbs_Prototype.rport_If_sr_Speed
    connect PiaWrp_Prototype.pport_If_sr_PIA_ProfileData -> SwcCbsWrp_Prototype.rport_If_sr_PIA_ProfileData
    connect PiaWrp_Prototype.pport_If_sr_PIA_ProfileData -> SwcCbs_Prototype.rport_If_PIA_ProfileData
    connect PiaWrp_Prototype.pport_If_sr_PIA_ProfileData -> SwcCcmWrp_Prototype.rport_If_PIA_ProfileData
    connect SwcRda_Prototype.pport_If_sr_Rda -> SwcCbs_Prototype.rport_If_sr_Rda
    connect SwcCbs_Prototype.pport_If_cs_Cbs_NvmData -> SwcRda_Prototype.rport_If_cs_Cbs_NvmData
    connect SwcCbs_Prototype.pport_If_sr_Cbs -> SwcRda_Prototype.rport_If_sr_Cbs
    connect CddStub_Prototype.pport_If_sr_Clock -> SwcCbs_Prototype.rport_If_sr_Clock
    connect CddStub_Prototype.pport_If_sr_Clock -> SwcCbsWrp_Prototype.rport_If_sr_Clock
    connect SwcKsm_Prototype.PPort_If_sr_System -> SwcCbsWrp_Prototype.rport_If_sr_System
    connect SwcKsm_Prototype.PPort_If_sr_System -> SwcCbs_Prototype.rport_If_sr_System
    connect SwcKsm_Prototype.PPort_If_sr_System -> SwcCcmWrp_Prototype.rport_If_sr_System
    connect SwcCbsWrp_Prototype.pport_If_sr_SBAString -> SwcCcmWrp_Prototype.rport_If_sr_SBAString
    connect SwcCbsWrp_Prototype.pport_If_sr_CbsFlags -> SwcCcmWrp_Prototype.rport_If_sr_CbsFlags
    connect SwcCbsWrp_Prototype.pport_If_cs_Cbs_TCU -> SwcCbs_Prototype.rport_If_cs_Cbs_TCU
    connect SwcCbsWrp_Prototype.pport_If_cs_CbsWrp_SetClrCcMessage -> SwcCbs_Prototype.rport_If_cs_CbsWrp_SetClrCcMessage
    connect SwcCbs_Prototype.pport_If_cs_Cbs_QueryData -> SwcCbsWrp_Prototype.rport_If_cs_Cbs_QueryData
    connect SwcCbs_Prototype.pport_If_cs_Cbs_ServiceCall -> SwcCbsWrp_Prototype.rport_If_cs_Cbs_ServiceCall
    connect SwcCbs_Prototype.pport_If_cs_Cbs_Modification -> SwcCbsWrp_Prototype.rport_If_cs_Cbs_Modification
    connect SwcTmm_Prototype.pport_If_sr_Tmm -> SwcCbsWrp_Prototype.rport_If_sr_Tmm
    connect SwcTmm_Prototype.pport_If_sr_Tmm -> SwcCbs_Prototype.rport_If_sr_Tmm
    connect SwcUcv_Prototype.pport_If_cs_Ucv_Converter -> PiaWrp_Prototype.rport_If_cs_Ucv_Converter
    connect CddErm_Prototype.pport_If_sr_Erm_Rx_Frame_MEMORYVERSTELLUNG -> PiaWrp_Prototype.rport_If_sr_Erm_Rx_Frame_MEMORYVERSTELLUNG
    connect CddErm_Prototype.pport_If_sr_Erm_Rx_Frame_PIA_TRANA -> PiaWrp_Prototype.rport_If_sr_Erm_Rx_Frame_PIA_TRANA
    connect CddErm_Prototype.pport_If_sr_Erm_Rx_Frame_PIA_SU -> PiaWrp_Prototype.rport_If_sr_Erm_Rx_Frame_PIA_SU
    connect CddErm_Prototype.pport_If_sr_Erm_Rx_Frame_PIA_DT_SET -> PiaWrp_Prototype.rport_If_sr_Erm_Rx_Frame_PIA_DT_SET
    connect CddErm_Prototype.pport_If_sr_Erm_Rx_Frame_PIA_DT_INQY -> PiaWrp_Prototype.rport_If_sr_Erm_Rx_Frame_PIA_DT_INQY
    connect CddErm_Prototype.pport_If_sr_Erm_Rx_Frame_OP_EINHEITEN -> PiaWrp_Prototype.rport_If_sr_PiaWrp_Rx_OP_EINHEITEN
    connect CddErm_Prototype.pport_If_sr_Erm_Rx_Frame_STAT_FUNKSCHLUESSEL -> PiaWrp_Prototype.rport_If_sr_Erm_Rx_Frame_STAT_FUNKSCHLUESSEL
    connect CddErm_Prototype.pport_If_sr_Erm_Rx_Frame_OP_IDLV_COOD_DISP_DXP -> PiaWrp_Prototype.rport_If_sr_PiaWrp_Rx_Frame_OP_IDLV_COOD_DISP_DXP
    connect CddErm_Prototype.pport_If_sr_Erm_Rx_Frame_OP_HUD_3 -> PiaWrp_Prototype.rport_If_sr_Erm_Rx_Frame_OP_HUD_3
    connect CddErm_Prototype.pport_If_sr_Erm_Rx_Frame_OP_SU_KI_4 -> PiaWrp_Prototype.rport_If_sr_PiaWrp_Rx_OP_SU_KI_4
    connect CddErm_Prototype.pport_If_sr_Erm_Rx_Frame_OP_SU_KI_5 -> PiaWrp_Prototype.rport_If_sr_Erm_Rx_Frame_OP_SU_KI_5
    connect HMIIF_Prototype.pport_If_sr_Hmi_RequestBc -> PiaWrp_Prototype.rport_If_sr_Hmi_RequestBc
    connect HMIIF_Prototype.pport_If_sr_Hmi_Pia -> PiaWrp_Prototype.rport_PiaWrp_If_sr_Hmi_Pia
    connect PiaWrp_Prototype.pport_If_sr_PIA_ProfileData_Ext -> PiaWrp_Prototype.rport_If_sr_PIA_ProfileData_Ext
    connect CddSafMLLD_Prototype.pport_if_cs_SafM_To_SafMLLD -> AC_SAFM_Prototype.rport_if_cs_SafM_To_SafMLLD
    connect AC_SAFM_Prototype.pport_if_cs_SafMLLD_To_SafM -> CddSafMLLD_Prototype.rport_if_cs_SafMLLD_To_SafM
    connect HMIIF_Prototype.pport_If_sr_Hmi_To_CbsWrp -> SwcCbsWrp_Prototype.rport_If_sr_Hmi_To_CbsWrp
    connect SwcDim_Prototype.pport_If_sr_Dim -> HMIIF_Prototype.rport_If_sr_Dim
    connect HMIIF_Prototype.pport_If_sr_Elc_PowermeterHMI -> SwcElc_Prototype.rport_If_sr_Elc_PowermeterHMI
    connect SwcLdm_Prototype.pport_If_sr_Ldm_Sta -> HMIIF_Prototype.rport_If_sr_Ldm_Sta
    connect SwcLdm_Prototype.pport_If_sr_Ldm_Wbk -> HMIIF_Prototype.rport_If_sr_Ldm_Wbk
    connect SwcLdm_Prototype.pport_If_sr_Ldm_Sym -> HMIIF_Prototype.rport_If_sr_Ldm_Sym
    connect CddErm_Prototype.pport_If_cs_Erm -> ErmWrp_Prototype.rport_If_cs_Erm
    connect SwcUcv_Prototype.pport_If_sr_ATemp -> HMIIF_Prototype.rport_If_sr_ATemp
    connect SwcUcv_Prototype.pport_If_sr_Odometer -> HMIIF_Prototype.rport_If_sr_Odometer
    connect SwcKlb_Prototype.pport_If_sr_Klb_Telltale -> HMIIF_Prototype.rport_If_sr_Klb_Telltale
    connect SwcGear_Prototype.pport_If_sr_Gear -> HMIIF_Prototype.rport_If_sr_Gear
    connect Coding.ReadProtocolData -> DcmInstance.DataServices_DcmDspData_ReadProtocolData
    connect SwcUcv_Prototype.pport_If_sr_ATemp -> HMIIF_Prototype.ATemp
    connect SwcUcv_Prototype.pport_If_sr_Odometer -> HMIIF_Prototype.Odometer
    connect SwcUcv_Prototype.pport_If_sr_Ucv_Speed -> HMIIF_Prototype.rport_If_sr_Ucv_Speed
    connect SwcUcv_Prototype.pport_If_sr_Ucv_Leds -> HMIIF_Prototype.rport_If_sr_Ucv_Leds
    connect SwcUcv_Prototype.pport_If_sr_Range -> HMIIF_Prototype.Range
    connect SwcUcv_Prototype.pport_If_sr_Range -> HMIIF_Prototype.rport_If_Sr_Range
    connect SwcUcv_Prototype.pport_If_sr_Tank -> HMIIF_Prototype.Tank
    connect SwcUcv_Prototype.pport_If_sr_Temperature_System_ICE -> HMIIF_Prototype.Temperature_System_ICE
    connect SwcUcv_Prototype.pport_If_sr_Temperature_System_ICE -> HMIIF_Prototype.rport_If_sr_Temperature_System_ICE
    connect SwcGear_Prototype.pport_If_sr_GearData -> HMIIF_Prototype.rport_If_sr_GearData
    connect SwcGear_Prototype.pport_If_sr_Gear -> HMIIF_Prototype.Gear
    connect HMIIF_Prototype.pport_If_sr_Hmi_RequestOdo -> SwcOdo_Prototype.rport_If_sr_Hmi_RequestOdo
    connect SwcCcm_Prototype.pport_If_sr_CheckControl -> HMIIF_Prototype.CheckControl
    connect SwcKlb_Prototype.pport_If_sr_Klb_Telltale -> HMIIF_Prototype.Telltale
    connect SwcKlb_Prototype.pport_If_sr_BEL -> HMIIF_Prototype.BEL
    connect HMIIF_Prototype.pport_If_sr_Hmi_TMData -> SwcCbs_Prototype.rport_If_sr_Hmi_TMData
    connect HMIIF_Prototype.pport_If_sr_Hmi_RequestCc -> SwcCcmWrp_Prototype.rport_If_sr_Hmi_RequestCc
    connect HMIIF_Prototype.pport_If_cs_CcmHmiData -> SwcCcmWrp_Prototype.rport_If_cs_CcmHmiData
    connect SwcElc_Prototype.pport_If_sr_Elc_PowermeterQuick -> HMIIF_Prototype.rport_If_sr_Elc_PowermeterQuick
    connect SwcElc_Prototype.pport_If_sr_Elc_PowermeterStandard -> HMIIF_Prototype.rport_If_sr_Elc_PowermeterStandard
    connect SwcElc_Prototype.pport_If_sr_Elc_PowermeterSlow -> HMIIF_Prototype.rport_If_sr_Elc_PowermeterSlow
    connect SwcLdm_Prototype.pport_If_sr_Ldm_AssistMode -> HMIIF_Prototype.AssistMode
    connect SwcElc_Prototype.pport_If_sr_Elc_ChargingScreen -> HMIIF_Prototype.Charging
    connect SwcTmm_Prototype.pport_If_sr_DisplayTimeKombi -> HMIIF_Prototype.DisplayTimeKombi
    connect SwcLdm_Prototype.pport_If_sr_LDM -> HMIIF_Prototype.LDM
    connect SwcLdm_Prototype.pport_If_sr_SLI_NPI -> HMIIF_Prototype.SLI_NPI
    connect SwcCbsWrp_Prototype.pport_If_sr_SBAData -> HMIIF_Prototype.rport_If_sr_SBAData
    connect SwcCbsWrp_Prototype.pport_If_sr_CbsWrp_To_Hmi -> HMIIF_Prototype.rport_If_sr_CbsWrp_To_Hmi
    connect SwcGbl_Prototype.pport_If_sr_HUDAdjustmentFrame -> HMIIF_Prototype.HUDAdjustmentFrame
    connect SwcUcv_Prototype.pport_If_cs_Ucv_Converter -> SwcLdm_Prototype.rport_If_cs_Ucv_Converter
    connect SwcUcv_Prototype.pport_If_sr_Ucv_HmiGaugeValues -> SwcLdmWrp_Prototype.rport_If_sr_Ucv_HmiGaugeValues
    connect SwcUcv_Prototype.pport_If_sr_Ucv_Speed -> SwcLdm_Prototype.rport_If_sr_Ucv_Speed
    connect SwcCcm_Prototype.pport_If_cs_Ccm_CheckPreDrive -> SwcLdmWrp_Prototype.rport_If_cs_Ccm_CheckPreDrive
    connect SwcCcm_Prototype.pport_If_cs_Ccm_SetClrMessage -> SwcLdm_Prototype.rport_If_cs_Ccm_SetClrMessage
    connect CddErm_Prototype.pport_If_sr_Erm_Rx_Frame_FuelSupply_ClassicCAN_CounterFuelingEvents -> SwcTnk_Prototype.rport_If_sr_Erm_Rx_Frame_FuelSupply_ClassicCAN_CounterFuelingEvents
    connect CddErm_Prototype.pport_If_sr_Erm_Rx_Frame_FuelSupply_ClassicCAN_FuelLevelEstimate -> SwcTnk_Prototype.rport_If_sr_Erm_Rx_Frame_FuelSupply_ClassicCAN_FuelLevelEstimate
    connect CddErm_Prototype.pport_If_sr_Erm_Rx_Frame_FuelSupply_ClassicCAN_RelativeFuelLevelEstimate -> SwcTnk_Prototype.rport_If_sr_Erm_Rx_Frame_FuelSupply_ClassicCAN_RelativeFuelLevelEstimate
    connect CddErm_Prototype.pport_If_cs_Erm -> SwcLdmWrp_Prototype.rport_If_cs_Erm
    connect CddErm_Prototype.pport_If_cs_Erm -> SwcLdm_Prototype.rport_If_cs_Erm
    connect CddErm_Prototype.pport_If_sr_Erm_Rx_Frame_RCPT_RQ_KI -> SwcLdmWrp_Prototype.rport_If_sr_Erm_Rx_Frame_RCPT_RQ_KI
    connect CddErm_Prototype.pport_If_sr_Erm_Rx_Frame_DISP_DRASY_LNG -> SwcLdmWrp_Prototype.rport_If_sr_Erm_Rx_Frame_DISP_DRASY_LNG
    connect CddErm_Prototype.pport_If_sr_Erm_Rx_Frame_DISP_DRASY_LNG -> SwcLdm_Prototype.rport_If_sr_Erm_Rx_Frame_DISP_DRASY_LNG
    connect CddErm_Prototype.pport_If_sr_Erm_Rx_Frame_RQ_WBK_DISP -> SwcLdm_Prototype.rport_If_sr_Erm_Rx_Frame_RQ_WKB_DISP
    connect CddErm_Prototype.pport_If_sr_Erm_Rx_Frame_DXP_MOD -> SwcLdmWrp_Prototype.rport_If_sr_Erm_Rx_Frame_DXP_MOD
    connect CddErm_Prototype.pport_If_sr_Erm_Rx_Frame_DXP_MOD -> SwcLdm_Prototype.rport_If_sr_Erm_Rx_Frame_DXP_MOD
    connect CddErm_Prototype.pport_If_sr_Erm_Rx_Frame_DISP_FRSG -> SwcLdm_Prototype.rport_If_sr_Erm_Rx_Frame_DISP_FRSG
    connect CddErm_Prototype.pport_If_sr_Erm_Rx_Frame_ANG_ACPD -> SwcLdm_Prototype.rport_If_sr_Erm_Rx_Frame_ANG_ACPD
    connect CddErm_Prototype.pport_If_sr_Erm_Rx_Frame_DISP_DRASY_LAG -> SwcLdm_Prototype.rport_If_sr_Erm_Rx_Frame_DISP_DRASY_LAG
    connect CddErm_Prototype.pport_If_sr_Erm_Rx_Frame_RQ_WBK_ACOU -> SwcLdm_Prototype.rport_If_sr_Erm_Rx_Frame_RQ_WKB_ACOU
    connect CddErm_Prototype.pport_If_sr_Erm_Rx_Frame_DISP_FRSG_2 -> SwcLdm_Prototype.rport_If_sr_Erm_Rx_Frame_DISP_FRSG_2
    connect CddErm_Prototype.pport_If_sr_Erm_Rx_Frame_REQ_EMS -> SwcLdm_Prototype.rport_If_sr_Erm_Rx_Frame_REQ_EMS
    connect CddErm_Prototype.pport_If_sr_Erm_Rx_Frame_DISP_DRASY_LNG_2 -> SwcLdm_Prototype.rport_If_sr_Erm_Rx_Frame_DISP_DRASY_LNG_2
    connect CddErm_Prototype.pport_If_sr_Erm_Rx_Frame_DISP_DRASY_MOD -> SwcLdm_Prototype.rport_If_sr_Erm_Rx_Frame_DISP_DRASY_MOD
    connect CddErm_Prototype.pport_If_sr_Erm_Rx_Frame_DISP_DRASY_LAG_2 -> SwcLdm_Prototype.rport_If_sr_Erm_Rx_Frame_DISP_DRASY_LAG_2
    connect SwcKlb_Prototype.pport_If_cs_Ccm_LampStatus_To_Klb -> SwcLdmWrp_Prototype.rport_If_cs_Ccm_LampStatus_To_Klb
    connect SwcKlb_Prototype.pport_If_cs_Ccm_LampStatus_To_Klb -> SwcLdm_Prototype.rport_If_cs_Ccm_LampStatus_To_Klb
    connect SwcBc_Prototype.pport_If_sr_Bc_Speed -> SwcLdm_Prototype.rport_If_sr_Bc_Speed
    connect SPD_Prototype.pport_If_sr_Speed -> SwcLdmWrp_Prototype.rport_If_sr_Speed
    connect PiaWrp_Prototype.pport_If_sr_PIA_ProfileData -> SwcLdmWrp_Prototype.rport_If_PIA_ProfileData
    connect PiaWrp_Prototype.pport_If_sr_PIA_ProfileData -> SwcLdm_Prototype.rport_If_PIA_ProfileData
    connect SwcLdm_Prototype.pport_If_sr_Ldm_General -> SwcLdmWrp_Prototype.rport_If_sr_Ldm_General
    connect SwcLdm_Prototype.pport_If_sr_Ldm_AccDcc -> SwcLdmWrp_Prototype.rport_If_sr_Ldm_AccDcc
    connect SwcLdm_Prototype.pport_If_sr_Ldm_Sym -> SwcLdmWrp_Prototype.rport_If_sr_Ldm_Sym
    connect SwcLdm_Prototype.pport_If_sr_Ldm_iBrake -> SwcLdmWrp_Prototype.rport_If_sr_Ldm_iBrake
    connect SwcLdm_Prototype.pport_If_sr_Ldm_Sta -> SwcLdmWrp_Prototype.rport_If_sr_Ldm_Sta
    connect SwcLdmWrp_Prototype.pport_If_sr_MaxSpeedoValue -> SwcLdm_Prototype.rport_If_sr_Max_Speedo_Value
    connect SwcKsm_Prototype.PPort_If_sr_System -> SwcLdm_Prototype.rport_If_sr_System
    connect SwcLdm_Prototype.pport_If_sr_Ldm_Wbk -> SwcLdmWrp_Prototype.rport_If_sr_Ldm_Wbk
    connect SwcLdm_Prototype.pport_If_sr_Ldm_CruiseControl -> SwcLdmWrp_Prototype.rport_If_sr_Ldm_CruiseControl
    connect SwcLdm_Prototype.pport_If_sr_Ldm_Vas -> SwcLdmWrp_Prototype.rport_If_sr_Ldm_Vas
    connect SwcKsm_Prototype.PPort_If_sr_System -> SwcLdmWrp_Prototype.rport_If_sr_System
    connect SwcGear_Prototype.pport_If_sr_GearData -> SwcElc_Prototype.rport_If_sr_Gear
    connect CddErm_Prototype.pport_If_sr_Erm_Rx_Frame_CHGNG_ST -> SwcElc_Prototype.rport_If_sr_Erm_Rx_Frame_CHGNG_ST
    connect CddErm_Prototype.pport_If_sr_Erm_Rx_Frame_DXP_MOD -> SwcElc_Prototype.rport_If_sr_Erm_Rx_Frame_DXP_MOD
    connect CddErm_Prototype.pport_If_sr_Erm_Rx_Frame_ST_CHGINTF -> SwcElc_Prototype.rport_If_sr_Erm_Rx_Frame_ST_CHGINTF
    connect CddErm_Prototype.pport_If_sr_Erm_Rx_Frame_DISP_CON_HYB -> SwcElc_Prototype.rport_If_sr_Erm_Rx_Frame_DISP_CON_HYB
    connect CddErm_Prototype.pport_If_sr_Erm_Rx_Frame_STAT_ENG_STA_AUTO -> SwcElc_Prototype.rport_If_sr_Erm_Rx_Frame_STAT_ENG_STA_AUTO
    connect CddErm_Prototype.pport_If_sr_Erm_Rx_Frame_DISP_RPM_PT -> SwcElc_Prototype.rport_If_sr_Erm_Rx_Frame_DISP_RPM_PT
    connect CddErm_Prototype.pport_If_sr_Erm_Rx_Frame_DISP_DT_HVSTO -> SwcElc_Prototype.rport_If_sr_Erm_Rx_Frame_DISP_DT_HVSTO
    connect CddErm_Prototype.pport_If_sr_Erm_Rx_Frame_DISP_SW_DRDY_TECGY_EXPI -> SwcElc_Prototype.rport_If_sr_Erm_Rx_Frame_DISP_SW_DRDY_TECGY_EXPI
    connect CddErm_Prototype.pport_If_sr_Erm_Rx_Frame_STAT_ZV_KLAPPEN -> SwcElc_Prototype.rport_If_sr_Erm_Rx_Frame_STAT_ZV_KLAPPEN
    connect CddErm_Prototype.pport_If_sr_Erm_Rx_Frame_SU_SOC_HLD -> SwcElc_Prototype.rport_If_sr_Erm_Rx_Frame_SU_SOC_HLD
    connect CddErm_Prototype.pport_If_sr_Erm_Rx_Frame_Battery_SOE -> HMIIF_Prototype.Battery_SOE
    connect SwcElc_Prototype.pport_If_sr_Battery_SOE -> HMIIF_Prototype.Battery_SOE
    connect SwcElc_Prototype.pport_If_sr_Klb_Telltale -> HMIIF_Prototype.Telltale
    connect SPD_Prototype.pport_If_sr_Speed -> SwcElc_Prototype.rport_If_sr_Speed
    connect PiaWrp_Prototype.pport_If_sr_PIA_ProfileData -> SwcElc_Prototype.rport_If_PIA_ProfileData
    connect SwcKsm_Prototype.PPort_If_sr_System -> SwcElc_Prototype.rport_If_sr_System
    connect Cdd_CustomerTime_Prototype.pport_If_sr_Clock -> SwcAtp_Prototype.rport_If_sr_Clock
    connect Cdd_CustomerTime_Prototype.pport_If_sr_HWClock -> SwcTmm_Prototype.rport_If_sr_HWClock
    connect Cdd_CustomerTime_Prototype.pport_If_cs_RealTimeClock -> SwcTmm_Prototype.rport_If_cs_RealTimeClock
package /Systems
  system Kombi
    system mapping EBConnectionEditorMappings
      data-mappings:
        sender-receiver-to-signal-mapping={data-element=SysTime.Kombi_CPUInstance.SystemComponentPrototype.SysTimeRx.timeSignal, system-signal=T_SEC_COU_REL}
        sender-receiver-to-signal-mapping={data-element=Stm.Kombi_CPUInstance.SystemComponentPrototype.CentralErrorLockRx.centralErrorLock, system-signal=ST_ILK_ERRM_FZM}
        sender-receiver-to-signal-group-mapping={data-element=Kombi_CPUInstance.SystemComponentPrototype.RP_SGG_Rx_CON_VEH.IntegrationSample_IDT_CON_VEH, signal-group=sigGroup_CON_VEH, type-mapping=sender-rec-record-type-mapping=record-element-mappings=[{implementation-record-element=IntegrationSample_CTR_BS_PRTNT, system-signal=CTR_BS_PRTNT}, {implementation-record-element=IntegrationSample_CTR_FKTN_PRTNT, system-signal=CTR_FKTN_PRTNT}, {implementation-record-element=IntegrationSample_ST_CON_VEH, system-signal=ST_CON_VEH}]}
        sender-receiver-to-signal-group-mapping={data-element=Kombi_CPUInstance.Vin.SystemComponentPrototype.ComVin.ComVin, signal-group=sigGroup_FAHRGESTELLNUMMER, type-mapping=sender-rec-record-type-mapping=record-element-mappings=[{implementation-record-element=Vin1, system-signal=NO_VECH_1}, {implementation-record-element=Vin2, system-signal=NO_VECH_2}, {implementation-record-element=Vin3, system-signal=NO_VECH_3}, {implementation-record-element=Vin4, system-signal=NO_VECH_4}, {implementation-record-element=Vin5, system-signal=NO_VECH_5}, {implementation-record-element=Vin6, system-signal=NO_VECH_6}, {implementation-record-element=Vin7, system-signal=NO_VECH_7}]}
        sender-receiver-to-signal-mapping={data-element=Kombi_CPUInstance.Vin.SystemComponentPrototype.VinRequest.RequestMessageIdentifier, system-signal=ID_FN_INQY}
        sender-receiver-to-signal-group-mapping={data-element=Kombi_CPUInstance.SPD_Prototype.SystemComponentPrototype.pport_If_sr_Port_Tx_ST_DISP_DRASY.ST_DISP_DRASY, signal-group=sigGroup_ST_DISP_DRASY, type-mapping=sender-rec-record-type-mapping=record-element-mappings=[{implementation-record-element=CRC_ST_DISP_DRASY, system-signal=CRC_ST_DISP_DRASY}, {implementation-record-element=ALIV_ST_DISP_DRASY, system-signal=ALIV_ST_DISP_DRASY}, {implementation-record-element=CHL_ST_DISP_DRASY, system-signal=CHL_ST_DISP_DRASY}, {implementation-record-element=AVL_V_SPDM_2, system-signal=AVL_V_SPDM_2}, {implementation-record-element=UN_V_SPDM, system-signal=UN_V_SPDM}, {implementation-record-element=ST_DISP_PMA, system-signal=ST_DISP_PMA}, {implementation-record-element=AVAI_DISP_KI, system-signal=AVAI_DISP_KI}, {implementation-record-element=ST_DISP_XCC, system-signal=ST_DISP_XCC}, {implementation-record-element=ST_DISP_HDC, system-signal=ST_DISP_HDC}, {implementation-record-element=ST_DISP_SD, system-signal=ST_DISP_DRASY_dummy_44_47}, {implementation-record-element=ST_DISP_DRASY_LAG, system-signal=ST_DISP_DRASY_LAG}, {implementation-record-element=ST_DISP_ISA_2, system-signal=ST_DISP_ISA_2}, {implementation-record-element=ST_DISP_GAP_INFO_2, system-signal=ST_DISP_GAP_INFO_2}, {implementation-record-element=ST_DISP_WBK, system-signal=ST_DISP_WBK}]}
        sender-receiver-to-signal-mapping={data-element=Kombi_CPUInstance.SwcUcv_Prototype.SystemComponentPrototype.pport_If_sr_Port_Tx_ANZEIGE_KI_EXTN_ANZEIGE.DISP_TEMP_EX_Tx, system-signal=DISP_TEMP_EX}
        sender-receiver-to-signal-mapping={data-element=Kombi_CPUInstance.SwcUcv_Prototype.SystemComponentPrototype.pport_If_sr_Port_Tx_ANZEIGE_KI_EXTN_ANZEIGE.ST_UN_TEMP_KI_Tx, system-signal=ST_UN_TEMP_KI}
        sender-receiver-to-signal-mapping={data-element=Kombi_CPUInstance.SwcAtp_Prototype.SystemComponentPrototype.pport_If_sr_Port_Tx_A_TEMP.TEMP_EX_Tx, system-signal=TEMP_EX}
        sender-receiver-to-signal-mapping={data-element=Kombi_CPUInstance.SwcAtp_Prototype.SystemComponentPrototype.pport_If_sr_Port_Tx_A_TEMP.TEMP_EX_UNFILT_Tx, system-signal=TEMP_EX_UNFILT}
        sender-receiver-to-signal-mapping={data-element=Kombi_CPUInstance.SwcUcv_Prototype.SystemComponentPrototype.pport_If_sr_Port_Tx_KILOMETERSTAND.MILE_KM_Tx, system-signal=MILE_KM}
        sender-receiver-to-signal-mapping={data-element=Kombi_CPUInstance.SwcUcv_Prototype.SystemComponentPrototype.pport_If_sr_Port_Tx_KILOMETERSTAND.FLLV_FUTA_Tx, system-signal=FLLV_FUTA}
        sender-receiver-to-signal-mapping={data-element=Kombi_CPUInstance.SwcUcv_Prototype.SystemComponentPrototype.pport_If_sr_Port_Tx_KILOMETERSTAND.FLLV_FUTA_LH_Tx, system-signal=FLLV_FUTA_LH}
        sender-receiver-to-signal-mapping={data-element=Kombi_CPUInstance.SwcUcv_Prototype.SystemComponentPrototype.pport_If_sr_Port_Tx_KILOMETERSTAND.FLLV_FUTA_RH_Tx, system-signal=FLLV_FUTA_RH}
        sender-receiver-to-signal-mapping={data-element=Kombi_CPUInstance.SwcUcv_Prototype.SystemComponentPrototype.pport_If_sr_Port_Tx_KILOMETERSTAND.ST_FLLV_FUTA_SPAR_Tx, system-signal=ST_FLLV_FUTA_SPAR}
        sender-receiver-to-signal-mapping={data-element=Kombi_CPUInstance.SwcUcv_Prototype.SystemComponentPrototype.pport_If_sr_Port_Tx_KILOMETERSTAND.RNG_Tx, system-signal=RNG}
        sender-receiver-to-signal-mapping={data-element=Kombi_CPUInstance.SwcOdoWrp_Prototype.SystemComponentPrototype.pport_If_sr_Port_Tx_KILOMETERSTAND_2.TOTAL_MILE_Tx, system-signal=MILE_KM_TOT}
        sender-receiver-to-signal-mapping={data-element=Kombi_CPUInstance.SwcTmm_Prototype.SystemComponentPrototype.pport_If_sr_Port_Tx_UHRZEIT_DATUM_UTC.HR_UTC_Tx, system-signal=HR_UTC}
        sender-receiver-to-signal-mapping={data-element=Kombi_CPUInstance.SwcTmm_Prototype.SystemComponentPrototype.pport_If_sr_Port_Tx_UHRZEIT_DATUM_UTC.MN_UTC_Tx, system-signal=MN_UTC}
        sender-receiver-to-signal-mapping={data-element=Kombi_CPUInstance.SwcTmm_Prototype.SystemComponentPrototype.pport_If_sr_Port_Tx_UHRZEIT_DATUM_UTC.SEC_UTC_Tx, system-signal=SEC_UTC}
        sender-receiver-to-signal-mapping={data-element=Kombi_CPUInstance.SwcTmm_Prototype.SystemComponentPrototype.pport_If_sr_Port_Tx_UHRZEIT_DATUM_UTC.DATE_DAY_UTC_Tx, system-signal=DATE_DAY_UTC}
        sender-receiver-to-signal-mapping={data-element=Kombi_CPUInstance.SwcTmm_Prototype.SystemComponentPrototype.pport_If_sr_Port_Tx_UHRZEIT_DATUM_UTC.DATE_YR_UTC_Tx, system-signal=DATE_YR_UTC}
        sender-receiver-to-signal-mapping={data-element=Kombi_CPUInstance.SwcTmm_Prototype.SystemComponentPrototype.pport_If_sr_Port_Tx_UHRZEIT_DATUM_UTC.ST_CTI_DATE_UTC_Tx, system-signal=ST_CTI_DATE_UTC}
        sender-receiver-to-signal-mapping={data-element=Kombi_CPUInstance.SwcTmm_Prototype.SystemComponentPrototype.pport_If_sr_Port_Tx_UHRZEIT_DATUM_UTC.DATE_MON_UTC_Tx, system-signal=DATE_MON_UTC}
        sender-receiver-to-signal-mapping={data-element=Kombi_CPUInstance.SwcTmm_Prototype.SystemComponentPrototype.pport_If_sr_Port_Tx_UHRZEIT_DATUM_UTC.TZS_OFFS_AUTOMLY_UTC_Tx, system-signal=TZS_OFFS_AUTOMLY_UTC}
        sender-receiver-to-signal-mapping={data-element=Kombi_CPUInstance.SwcTmm_Prototype.SystemComponentPrototype.pport_If_sr_Port_Tx_UHRZEIT_DATUM_UTC.OFFS_WIT_SUT_UTC_Tx, system-signal=OFFS_WIT_SUT_UTC}
        sender-receiver-to-signal-mapping={data-element=Kombi_CPUInstance.SwcTmm_Prototype.SystemComponentPrototype.pport_If_sr_Port_Tx_ST_CTI_DATE.ST_TZS_OFFS_Tx, system-signal=ST_TZS_OFFS}
        sender-receiver-to-signal-mapping={data-element=Kombi_CPUInstance.SwcTmm_Prototype.SystemComponentPrototype.pport_If_sr_Port_Tx_ST_CTI_DATE.ST_CHB_T_ADJU_AUTOMLY_Tx, system-signal=ST_CHB_T_ADJU_AUTOMLY}
        sender-receiver-to-signal-mapping={data-element=Kombi_CPUInstance.SwcTmm_Prototype.SystemComponentPrototype.pport_If_sr_Port_Tx_ST_CTI_DATE.ST_TZS_ID_Tx, system-signal=ST_TZS_ID}
        sender-receiver-to-signal-mapping={data-element=Kombi_CPUInstance.SwcDimWrp_Prototype.SystemComponentPrototype.pport_If_sr_Port_Tx_LCD_BRIG_CLCTR.u8TgLum, system-signal=DSTN_LCD_LUM}
        sender-receiver-to-signal-mapping={data-element=Kombi_CPUInstance.SwcDimWrp_Prototype.SystemComponentPrototype.pport_If_sr_Port_Tx_LCD_BRIG_CLCTR.u8Damping, system-signal=DMPNG_LCD_LUM}
        sender-receiver-to-signal-mapping={data-element=Kombi_CPUInstance.SwcDimWrp_Prototype.SystemComponentPrototype.pport_If_sr_Port_Tx_LCD_BRIG_CLCTR.u8ADCIn, system-signal=AMBR_1}
        sender-receiver-to-signal-mapping={data-element=Kombi_CPUInstance.SwcDimWrp_Prototype.SystemComponentPrototype.pport_If_sr_Port_Tx_LCD_BRIG_CLCTR.u8NightMode, system-signal=DAY_NI_CHOV}
        sender-receiver-to-signal-mapping={data-element=Kombi_CPUInstance.SwcDimWrp_Prototype.SystemComponentPrototype.pport_If_sr_Port_Tx_DimmingInteriorIllumination.u8DampingInteriorIllumination, system-signal=DampingInteriorIllumination}
        sender-receiver-to-signal-mapping={data-element=Kombi_CPUInstance.SwcDimWrp_Prototype.SystemComponentPrototype.pport_If_sr_Port_Tx_DimmingInteriorIllumination.u8TargetLuminanceBacklight, system-signal=TargetLuminanceBacklight}
        sender-receiver-to-signal-mapping={data-element=Kombi_CPUInstance.SwcDimWrp_Prototype.SystemComponentPrototype.pport_If_sr_Port_Tx_DimmingInteriorIllumination.u16TargetLuminanceFunctionlight, system-signal=TargetLuminanceFunctionlight}
        sender-receiver-to-signal-mapping={data-element=Kombi_CPUInstance.SwcDimWrp_Prototype.SystemComponentPrototype.pport_If_sr_Port_Tx_DimmingInteriorIllumination.u16FollowUpTimeSecondsBacklight, system-signal=FollowUpTimeSecondsBacklight}
        sender-receiver-to-signal-mapping={data-element=Kombi_CPUInstance.SwcDimWrp_Prototype.SystemComponentPrototype.pport_If_sr_Port_Tx_DimmingInteriorIllumination.u8ChangeOverDayNight, system-signal=ChangeOverDayNight}
        sender-receiver-to-signal-mapping={data-element=Kombi_CPUInstance.SwcDimWrp_Prototype.SystemComponentPrototype.pport_If_sr_Port_Tx_DimmingInteriorIllumination.u8ControlBacklight, system-signal=ControlBacklight}
        sender-receiver-to-signal-mapping={data-element=Kombi_CPUInstance.SwcDimWrp_Prototype.SystemComponentPrototype.pport_If_sr_Port_Tx_DimmingInteriorIllumination.u8ControlCalmedMode, system-signal=ControlCalmedMode}
        sender-receiver-to-signal-group-mapping={data-element=Kombi_CPUInstance.SwcLdmWrp_Prototype.SystemComponentPrototype.pport_If_sr_Port_Tx_ST_DISP_DRASY.ST_DISP_DRASY, signal-group=sigGroup_ST_DISP_DRASY, type-mapping=sender-rec-record-type-mapping=record-element-mappings=[{implementation-record-element=CRC_ST_DISP_DRASY, system-signal=CRC_ST_DISP_DRASY}, {implementation-record-element=ALIV_ST_DISP_DRASY, system-signal=ALIV_ST_DISP_DRASY}, {implementation-record-element=CHL_ST_DISP_DRASY, system-signal=CHL_ST_DISP_DRASY}, {implementation-record-element=AVL_V_SPDM_2, system-signal=AVL_V_SPDM_2}, {implementation-record-element=UN_V_SPDM, system-signal=UN_V_SPDM}, {implementation-record-element=ST_DISP_PMA, system-signal=ST_DISP_PMA}, {implementation-record-element=AVAI_DISP_KI, system-signal=AVAI_DISP_KI}, {implementation-record-element=ST_DISP_XCC, system-signal=ST_DISP_XCC}, {implementation-record-element=ST_DISP_HDC, system-signal=ST_DISP_HDC}, {implementation-record-element=ST_DISP_SD, system-signal=ST_DISP_DRASY_dummy_44_47}, {implementation-record-element=ST_DISP_DRASY_LAG, system-signal=ST_DISP_DRASY_LAG}, {implementation-record-element=ST_DISP_ISA_2, system-signal=ST_DISP_ISA_2}, {implementation-record-element=ST_DISP_GAP_INFO_2, system-signal=ST_DISP_GAP_INFO_2}, {implementation-record-element=ST_DISP_WBK, system-signal=ST_DISP_WBK}]}
      sw-mappings:
        swc to ecu mapping EBConnectionEditorSwcMappings: ecu-instance=Kombi
          component:
            SystemComponentPrototype.Kombi_CPUInstance.iicb_Prototype
            SystemComponentPrototype.Kombi_CPUInstance.IOSAL_Prototype
            SystemComponentPrototype.Kombi_CPUInstance.SwcCDBus_Prototype
            SystemComponentPrototype.Kombi_CPUInstance.SwcUcv_Prototype
            SystemComponentPrototype.Kombi_CPUInstance.BifSample_Prototype
            SystemComponentPrototype.Kombi_CPUInstance.CDDBIF_Prototype
            SystemComponentPrototype.Kombi_CPUInstance.SwcGear_Prototype
            SystemComponentPrototype.Kombi_CPUInstance.CddVMon_Prototype
            SystemComponentPrototype.Kombi_CPUInstance.SwcAtp_Prototype
            SystemComponentPrototype.Kombi_CPUInstance.SwcOdo_Prototype
            SystemComponentPrototype.Kombi_CPUInstance.SwcCcm_Prototype
            SystemComponentPrototype.Kombi_CPUInstance.SwcTnk_Prototype
            SystemComponentPrototype.Kombi_CPUInstance.CddErm_Prototype
            SystemComponentPrototype.Kombi_CPUInstance.SwcKlb_Prototype
            SystemComponentPrototype.Kombi_CPUInstance.HMIIF_Prototype
            SystemComponentPrototype.Kombi_CPUInstance.SwcBc_Prototype
            SystemComponentPrototype.Kombi_CPUInstance.SPD_Prototype
            SystemComponentPrototype.Kombi_CPUInstance.PiaWrp_Prototype
            SystemComponentPrototype.Kombi_CPUInstance.SwcEci_Prototype
            SystemComponentPrototype.Kombi_CPUInstance.SwcDim_Prototype
            SystemComponentPrototype.Kombi_CPUInstance.AC_SAFM_Prototype
            SystemComponentPrototype.Kombi_CPUInstance.SwcLdm_Prototype
            SystemComponentPrototype.Kombi_CPUInstance.SwcRda_Prototype
            SystemComponentPrototype.Kombi_CPUInstance.SwcElc_Prototype
            SystemComponentPrototype.Kombi_CPUInstance.CDD_AMM_Prototype
            SystemComponentPrototype.Kombi_CPUInstance.CddStub_Prototype
            SystemComponentPrototype.Kombi_CPUInstance.SwcKsm_Prototype
            SystemComponentPrototype.Kombi_CPUInstance.SwcBcWrp_Prototype
            SystemComponentPrototype.Kombi_CPUInstance.SwcDimWrp_Prototype
            SystemComponentPrototype.Kombi_CPUInstance.CddSwcDfe_Prototype
            SystemComponentPrototype.Kombi_CPUInstance.CddDfeLld_Prototype
            SystemComponentPrototype.Kombi_CPUInstance.SwcOdoWrp_Prototype
            SystemComponentPrototype.Kombi_CPUInstance.SwcCcmWrp_Prototype
            SystemComponentPrototype.Kombi_CPUInstance.SwcCbsWrp_Prototype
            SystemComponentPrototype.Kombi_CPUInstance.CddSafMLLD_Prototype
            SystemComponentPrototype.Kombi_CPUInstance.CddHal_Prototype
            SystemComponentPrototype.Kombi_CPUInstance.CddHud_Prototype.SwcTST_Prototype
            SystemComponentPrototype.Kombi_CPUInstance.SwcTmm_Prototype
            SystemComponentPrototype.Kombi_CPUInstance.SwcCbs_Prototype
            SystemComponentPrototype.Kombi_CPUInstance.CddVMonWrp_Prototype
            SystemComponentPrototype.Kombi_CPUInstance.SwcLdmWrp_Prototype
            SystemComponentPrototype.Kombi_CPUInstance.ErmWrp_Prototype
            SystemComponentPrototype.Kombi_CPUInstance.SwcGbl_Prototype
            SystemComponentPrototype.Kombi_CPUInstance.Cdd_CustomerTime_Prototype
